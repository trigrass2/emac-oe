## meta-emac/conf/machine/vox-150.conf
```bitbake
#@TYPE: Machine
#@NAME: VOX-150

#@DESCRIPTION: Machine configuration for VOX-150.

MACHINE_FEATURES += " touchscreen "
MACHINE_FEATURES_remove = "efi"

include conf/machine/include/emac-x86.inc
include conf/machine/include/emac-x11.inc
include conf/machine/include/tune-i586.inc

## KERNEL
PREFERRED_VERSION_linux-emac = "4.9%"

## BOOTLOADER 
PREFERRED_PROVIDER_virtual/bootloader ?= "grub"
MACHINE_EXTRA_RDEPENDS += "grub"
MACHINE_EXTRA_RDEPENDS_remove = "grub-efi efibootmgr"

IMAGE_FSTYPES = "tar.gz"
RESOLUTION = "1024x768"
```
