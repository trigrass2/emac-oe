## meta-emac/conf/machine/include/emac-x86.inc
```bitbake
#
# Base machine settings for X86 architecture BSPs
#

PREFERRED_PROVIDER_virtual/kernel ?= "linux-emac-x86"
PREFERRED_VERSION_linux-emac-x86 ?= "3.19%"

PREFERRED_PROVIDER_virtual/xserver ?= "xserver-xorg"
XSERVER ?= "${XSERVER_X86_BASE} \
            ${XSERVER_X86_EXT} \
            ${XSERVER_X86_I915} \
            ${XSERVER_X86_I965} \
            ${XSERVER_X86_FBDEV} \
            ${XSERVER_X86_VESA} \
            ${XSERVER_X86_MODESETTING} \
            ${XSERVER_X86_TOUCH} \
           "

MACHINE_FEATURES += "screen pci usbhost x86 \
                     serial usbgadget sound bigflash "

BAD_RECOMMENDATIONS += " linux-firmware "

KERNEL_IMAGETYPE ?= "bzImage"
IMAGE_FSTYPES ?= "tar.gz"

SERIAL_CONSOLE ?= "115200 ttyS0"

COMBO_NUMBER = "1${MACHINE_NUMBER}${REV}"
EMAC_LINUX_VERSION_EXTENSION = "_SL400-XKN-${COMBO_NUMBER}.000"
PART_NUMBER = "SL050-XFN-${COMBO_NUMBER}.000"

#
# XSERVER subcomponents, used to build the XSERVER variable
#
XSERVER_X86_BASE = "xserver-xorg \
           xf86-input-mouse \
           xf86-input-keyboard \
           xf86-input-evdev \
           xf86-input-synaptics \
           "

XSERVER_X86_EXT = " \
           ${@base_contains('DISTRO_FEATURES', 'opengl', 'xserver-xorg-extension-glx', '', d)} \
           xserver-xorg-module-libint10 \
           "

XSERVER_X86_I915 = "xf86-video-intel \
           ${@base_contains('DISTRO_FEATURES', 'opengl', 'mesa-driver-i915', '', d)} \
           "

XSERVER_X86_I965 = "xf86-video-intel \
           ${@base_contains('DISTRO_FEATURES', 'opengl', 'mesa-driver-i965', '', d)} \
           "

XSERVER_X86_VESA = "xf86-video-vesa"

XSERVER_X86_FBDEV = "xf86-video-fbdev"

XSERVER_X86_TOUCH = " \
           ${@base_contains('MACHINE_FEATURES', 'touch', 'xf86-input-tslib', '', d)} \
           "

XSERVER_X86_MODESETTING = "xf86-video-modesetting"
```

## meta-emac/conf/machine/include/nxp/emac-imx6.inc
```bitbake
PREFERRED_PROVIDER_virtual/kernel ?= "linux-emac"
PREFERRED_VERSION_linux-emac ?= "4.19%"
PREFERRED_PROVIDER_virtual/bootloader = "u-boot-emac"
PREFERRED_PROVIDER_virtual/xserver ?= "xserver-xorg"
MACHINE_FEATURES:append = " arm "

SERIAL_CONSOLE ?= "115200 ttymxc1"
KERNEL_IMAGETYPE ?= "zImage"

UBOOT_SUFFIX = "img"
UBOOT_MACHINE ?= "somimx6dq_defconfig"


IMAGE_FSTYPES ?= "tar.gz"

XSERVER ?= " \
xserver-xorg \
    xserver-xorg-extension-dri2 \
    xserver-xorg-extension-glx \
    xserver-xorg-extension-extmod \
    xserver-xorg-extension-dbe \
    xf86-input-evdev \
    xf86-input-mouse \
    xf86-video-omapfb \
    xf86-video-fbdev \
    xf86-input-keyboard \
    xf86-input-tslib \
"
```

## meta-emac/conf/machine/include/x86/atom-sbc-64-x32.conf
```bitbake
#@TYPE: Machine
#@NAME: Atom-SIB-ia64
#@DESCRIPTION: Machine configuration for core2-64-x32(x86_64/i686 with binary emululation for 32 bit programs)

TARGET_ARCH = "x86_64"
DEFAULTTUNE = "core2-64-x32"
MACHINEOVERRIDES =. "x86_64:x86-64:atom-sbc-ia64"

include conf/machine/include/x86/emac-x11.inc
include conf/machine/include/x86/intel/atom.inc

KERNEL_MODS_NEEDED = " \
    kernel-module-ia64 \
"

MACHINE_FEATURES += " touchscreen "
# KERNEL_MODULE_AUTOLOAD

RESOLUTION = "1280x1024"
MACHINE_NUMBER = "S10"
KERNEL_REV = "00.000"
FILESYSTEM_REV = "00.000"
```

## meta-emac/conf/machine/include/x86/emac-x86.inc
```bitbake
MACHINE_FEATURES = " \
    acpi \
    alsa \
    bluetooth \
    efi \
    keyboard \
    pci \
    pcbios \
    screen \
    serial \
    usbgadget \
    usbhost \
    wifi \
"

## GLIB 
GLIBC_ADDONS = "nptl"

## KERNEL
PREFERRED_PROVIDER:virtual/kernel ?= "linux-emac"
REFERRED_VERSION:linux-emac ?= "5.10%"

#PREFERRED_PROVIDER:virtual/kernel ?= "linux-mainline"
#PREFERRED_VERSION:linux-emac ?= "5.15%"

KERNEL_IMAGETYPE ?= "bzImage"
EMAC_LINUX_VERSION_EXTENSION = "_${EMAC_LINUX_VERSION}${MACHINE_NUMBER}X${KERNEL_REV}.bzimg"

MACHINE_EXTRA_RRECOMMENDS:append = " \
    kernel-modules \
    linux-firmware \
"

## BOOTLOADER 
PREFERRED_PROVIDER:virtual/bootloader ?= "grub-efi"
MACHINE_EXTRA_RDEPENDS:append = " \
    grub-efi \
    efibootmgr \
"

## SERIAL 
SERIAL_CONSOLE = "115200 ttyS0"
SERIAL_CONSOLES_CHECK = "ttyS0"

MACHINEOVERRIDES ??= "x86"
include conf/machine/include/x86/x86-base.inc

## IMAGE
IMAGE_FSTYPES = "tar.gz wic wic.bmap iso live"
WKS_FILE = "x86.wks.in"
do_image_wic[depends] += "gptfdisk-native:do_populate_sysroot"
do_image_wic[recrdeptask] += "do_bootimg"
```

## meta-emac/conf/machine/include/x86/ft8270.conf
```bitbake
#@TYPE: Machine
#@NAME: FT8270

#@DESCRIPTION: Machine configuration for Faytech 8270

include conf/machine/include/x86/emac-x86.inc
include conf/machine/include/x86/emac-x11.inc
include conf/machine/include/x86/tune-atom.inc

MACHINE_FEATURES:append = " touchscreen "
MACHINE_EXTRA_RDEPENDS:append = " xf86-video-ati linux-firmware-iwlwifi-4965-2 linux-firmware-radeon "

RESOLUTION = "800x600"
```

## meta-emac/conf/machine/include/x86/intel/atom.inc
```bitbake
# Machine configuration for core2-64(x86_64/i686)
# Default image for all atom based products

DEFAULTTUNE ?= "core2-64"
MACHINEOVERRIDES =. "atom-sbc:"

include conf/machine/include/x86/emac-x86.inc
include conf/machine/include/x86/tune-core2.inc

MACHINE_FEATURES += " \
    atom-sbc \
"

#PREFERRED_PROVIDER:virtual/kernel = "linux-intel"
#PREFERRED_VERSION:linux-intel = "4.19%"
#BSP_SUBTYPE = "leafhill"


PREFERRED_PROVIDER:libva = "libva-intel"
PREFERRED_PROVIDER:libva-native = "libva-intel-native"
PREFERRED_PROVIDER:nativesdk-libva = "nativesdk-libva-intel"

PREFERRED_PROVIDER:libva-utils = "libva-utils-intel"
PREFERRED_PROVIDER:libva-native = "libva-utils-intel-native"
PREFERRED_PROVIDER:nativesdk-libva-utils = "nativesdk-libva-utils-intel"

## intel based feature set 
MACHINE_EXTRA_RDEPENDS += " \
    grub-efi \
    grub \
    efibootmgr \
    \
    linux-firmware-i915 \
    linux-firmware-iwlwifi \
    \
    libva \
    libva-utils \
    intel-vaapi-driver \
    gstreamer1.0-vaapi \
    intel-media-driver \
    intel-mediasdk \
    libgles3-mesa-dev \
    thermald \
    ${@bb.utils.contains('EMAC_DISPLAY', 'x11', ' ${XSERVER} ', '', d )} \
    ${@bb.utils.contains('EMAC_DISPLAY_HW', 'opengl', ' mesa-driver-i915 ', '', d)} \
"
# kernel-module-i915 
# metee 


## Add with meta-intel
#MACHINE_EXTRA_RRECOMMENDS += " \
#    intel-vaapi-driver \
#    gstreamer1.0-vaapi \
#"

## BOOTLOADER
GRUB_TIMEOUT ?= "5"
#GRUB_GFXMODE = "1024x768x32"
#GRUB_COLOR_NORMAL="green/black"
#GRUB_COLOR_HIGHLIGHT="light-gray/light-magenta"

##UTILS


## MISC 
```

## meta-emac/conf/machine/include/x86/pcm-3356.conf
```bitbake
#@TYPE: Machine
#@NAME: PCM-3356

#@DESCRIPTION: Machine configuration for AMD G-Series Processor T16R

include conf/machine/include/x86/emac-x86.inc
include conf/machine/include/x86/emac-x11.inc
include conf/machine/include/x86/tune-core2.inc

SERIAL_CONSOLE = "115200 ttyS2"

MACHINE_EXTRA_RDEPENDS:append = " xf86-video-ati "

RESOLUTION = "1280x1024"
GRUB_SERIAL_COMMAND = "ttyS2,115200"
```

## meta-emac/conf/machine/include/x86/ppc-150t.conf
```bitbake
#@TYPE: Machine
#@NAME: PPC-150T

#@DESCRIPTION: Machine configuration for PPC-150T.

include conf/machine/include/x86/emac-x86.inc
include conf/machine/include/x86/emac-x11.inc
include conf/machine/include/x86/tune-i586.inc

MACHINE_FEATURES += " touchscreen "
RESOLUTION = "1024x768"
```

## meta-emac/conf/machine/intel-x86.conf
```bitbake
#@TYPE: Machine
#@NAME: Emac Intel
#@DESCRIPTION: emac intell 

include conf/machine/intel-corei7-64.conf
include conf/machine/include/emac-x86.conf

RESOLUTION = "1024x768"

MACHINE_FEATURES_append = " \
    touchscreen \
"

EXTRA_IMAGEDEPENDS += " \
    grub-efi grub efibootmgr \
    \
    mesa libglapi glfw glew libglu freeglut \
    \
    linux-firmware-i915 linux-firmware-iwlwifi \
    gstreamer1.0-vaapi libva libva-utils intel-vaapi-driver \
    thermald \
    intel-media-driver intel-mediasdk \
    mesa-driver-i915 \
"

PREFERRED_PROVIDER_libva = "libva-intel"
PREFERRED_PROVIDER_libva-native = "libva-intel-native"
PREFERRED_PROVIDER_nativesdk-libva = "nativesdk-libva-intel"

PREFERRED_PROVIDER_libva-utils = "libva-utils-intel"
PREFERRED_PROVIDER_libva-native = "libva-utils-intel-native"
PREFERRED_PROVIDER_nativesdk-libva-utils = "nativesdk-libva-utils-intel"

## IMAGE
IMAGE_FSTYPES = "tar.gz wic"
WKS_FILE = "x86.wks.in"
do_image_wic[depends] += "gptfdisk-native:do_populate_sysroot"
do_image_wic[recrdeptask] += "do_bootimg"
 
```

## meta-emac/conf/machine/ipac9x25.conf
```bitbake
#@TYPE: Machine
#@NAME: ipac9x25

#@DESCRIPTION: Machine configuration for ipac9x25.

MACHINE_FEATURES += "bigflash can"

include conf/machine/include/emac-arm-at91.inc
include conf/machine/include/tune-arm926ejs.inc


IMAGE_INSTALL += "haveged"
PACKAGE_EXCLUDE = "rng-tools"

SERIAL_CONSOLE = "115200 ttyS5"
USE_VT = "0"

PREFERRED_VERSION_linux-emac = "5.10%"
KERNEL_DEVICETREE = "ipac-9x25.dtb"

UBOOT_MACHINE = "ipac9x25_config"

SOM_NUMBER = "08"
BOOTSTRAP_REV = "00.000"
UBOOT_REV = "00.000"
KERNEL_REV = "00.001"
FILESYSTEM_REV = "00.001"
```

## meta-emac/conf/machine/pcm-3356.conf
```bitbake
#@TYPE: Machine
#@NAME: PCM-3356
#@DESCRIPTION: Machine configuration for AMD G-Series Processor T16R

# AMD® G-Series™ Processor T16R 615 MHz /T40E 1.0GHz
# Supports up to 4GB DDR3L SODIMM/1G DDR3L On board memory
# Supports 18-bit LVDS and VGA
# Expansion: PC/104 and half size mini PCIe
# BIOS AMI 32-Mbit
# Graphics Engine DirectX 11 graphics with UVD 3.0, Open CL 1.1, Open GL 4.0
# Hardware decode (UVD 3) for H.264, VC-1 and MPEG2

# TODO
# https://github.com/3mdeb/meta-amd seems to be EOL so we would need to adapt this 
# or we need to make our own jmills

include conf/machine/include/x86/emac-x86.inc
include conf/machine/include/x86/emac-x11.inc
include conf/machine/include/x86/tune-core2.inc

SERIAL_CONSOLE = "115200 ttyS2"

MACHINE_EXTRA_RDEPENDS:append = " xf86-video-ati"

RESOLUTION = "1280x1024"
GRUB_SERIAL_COMMAND = "ttyS2,115200"
```

## meta-emac/conf/machine/pcm-9375.conf
```bitbake
#@TYPE: Machine
#@NAME: PCM-9375
#@DESCRIPTION: Machine configuration for AMD LX800 Processor

# AMD Geode™ low-power LX800 500 MHz processor

# WARNING 
# Graphics Engine AMD Geode LX800 2D engine (no opengl)
# Will not run moden webbrowsers without massive overhaul
# Most distros have dropped this processor due to how limited it is. 

# TODO
# https://github.com/3mdeb/meta-amd seems to be EOL so we would need to adapt this 
# or we need to make our own jmills

include conf/machine/include/x86/emac-x86.inc
include conf/machine/include/x86/emac-x11.inc
include conf/machine/include/x86/tune-i586.inc

RESOLUTION = "640x480 1280x1024"
MACHINE_NUMBER = "S09"
FILESYSTEM_REV = "00.000"
KERNEL_REV = "00.000"
```

## meta-emac/conf/machine/pmx.conf
```bitbake
#@TYPE: Machine
#@NAME: PMX
#@DESCRIPTION: Machine configuration for PMX panel PCs.

# https://www.vortex86.com/products/Vortex86MXPLUS

# WARNING 
# this should be EOL in OE 6.X

include conf/machine/include/x86/emac-x86.inc
include conf/machine/include/x86/emac-x11.inc
include conf/machine/include/x86/tune-i586.inc

MACHINE_FEATURES += " touchscreen "
RESOLUTION = "640x480 1024x600"
MACHINE_NUMBER = "001"

GRUB_CMDLINE_LINUX="noapic"
GRUB_GFXMODE = "829"
```

## meta-emac/conf/machine/ppc-150t.conf
```bitbake
#@TYPE: Machine
#@NAME: PPC-150T

#@DESCRIPTION: Machine configuration for PPC-150T.

# https://www.emacinc.com/products/panel_pcs_and_lcds/PPC-150T
# WARNING
# 2D Graphics engine support only
# will not work with moderen webbrowsers
# should be EOL for OE 6.X ? 

include conf/machine/include/x86/emac-x86.inc
include conf/machine/include/x86/emac-x11.inc
include conf/machine/include/x86/tune-i586.inc

MACHINE_FEATURES:remove = "efi"
## KERNEL
PREFERRED_VERSION_linux-emac = "4.9%"
## BOOTLOADER 
PREFERRED_PROVIDER_virtual/bootloader = "grub"
MACHINE_EXTRA_RDEPENDS += "grub"
MACHINE_EXTRA_RDEPENDS:remove = "grub-efi efibootmgr"

MACHINE_FEATURES += " touchscreen "
RESOLUTION = "1024x768"

IMAGE_FSTYPES = "tar.gz"
```

## meta-emac/conf/machine/som3354.conf
```bitbake
#@TYPE: Machine
#@NAME: SoM3354

#@DESCRIPTION: Machine configuration for EMAC's SoM-3354

MACHINE_FEATURES:append = "bigflash can screen touchscreen sound wifi "

MACHINE_EXTRA_RDEPENDS:append = " wf111-driver wf111-driver-tools wf111-driver-fw linux-firmware-sd8787 "

include conf/machine/include/ti/emac-omap.inc
include conf/machine/include/arm/armv7a/tune-cortexa8.inc

KERNEL_DEVICETREE = " \
	som-3354-200es.dtb \
	som-3354-200gs.dtb \
	som-3354-210es.dtb \
	som-3354-212es.dtb \
	som-3354-250es-7.dtb \
	som-3354-250es-10.dtb \
	som-3354-250gs-7.dtb \
"

UBOOT_MACHINE = "som3354_spiboot_config"
UBOOT_SUFFIX = "img"
SPL_BINARY = "MLO.byteswap spl/u-boot-spl.bin"

SOM_NUMBER = "08"
BOOTSTRAP_REV = "00.000"
UBOOT_REV = "00.000"
KERNEL_REV = "00.000"
FILESYSTEM_REV = "00.000"
```

## meta-emac/conf/machine/som3517.conf
```bitbake
#@TYPE: Machine
#@NAME: SoM3517

#@DESCRIPTION: Machine configuration for EMAC's SoM-3517

MACHINE_FEATURES:append  = " bigflash can screen touchscreen sound wifi"
MACHINE_EXTRA_RDEPENDS:append = " wf111-driver wf111-driver-tools wf111-driver-fw linux-firmware-sd8787 "

include conf/machine/include/ti/emac-omap.inc
include conf/machine/include/arm/armv7a/tune-cortexa8.inc

SERIAL_CONSOLE = "115200 ttyO2"

SOM_NUMBER = "09"
BOOTSTRAP_REV = "00.000"
UBOOT_REV = "00.000"
KERNEL_REV = "00.000"
FILESYSTEM_REV = "00.000"

DEFAULTTUNE = "armv7athf-neon"


PREFERRED_VERSION_linux-emac = "4.9%"
PREFERRED_VERSION_u-boot-emac = "v2016.01%"

KERNEL_DEVICETREE = " \
	som-3517-210es.dtb \
	som-3517-212es.dtb \
	som-3517-250gs-7.dtb \
"

SPL_BINARY = "MLO"
UBOOT_MACHINE = "som3517_config"
UBOOT_SUFFIX = "img"
```

## meta-emac/conf/machine/som9g25.conf
```bitbake
#@TYPE: Machine
#@NAME: som9g25

#@DESCRIPTION: Machine configuration for som9g25

MACHINE_FEATURES:append = " bigflash mtd wifi sound "

include conf/machine/include/atmel/emac-arm-at91.inc
include conf/machine/include/arm/armv5/tune-arm926ejs.inc

SERIAL_CONSOLE = "115200 ttyS5"
USE_VT = "0"

IMAGE_FSTYPES = "jffs2.sum"
MACHINE_EXTRA_RDEPENDS:append = " linux-firmware-bcm43430 "

JFFS2_ERASEBLOCK = "0x20000"
JFFS2_SUM_EXTRA_ARGS = "-e 0x20000 --no-cleanmarkers"

KERNEL_DEVICETREE = "som-9g25-150es.dtb som-9g25-112es.dtb"
UBOOT_MACHINE = "som9g25_config som9g25_128M_config"
AT91BOOTSTRAP_MACHINE = "som9g25_64M som9g25_128M"

SOM_NUMBER = "03"
BOOTSTRAP_REV = "00.000"
UBOOT_REV = "00.000"
KERNEL_REV = "00.001"
FILESYSTEM_REV = "00.000"
```

## meta-emac/conf/machine/som9x25.conf
```bitbake
#@TYPE: Machine
#@NAME: som9x25

#@DESCRIPTION: Machine configuration for som9x25

MACHINE_FEATURES += "bigflash can wifi sound"

include conf/machine/include/emac-arm-at91.inc
include conf/machine/include/tune-arm926ejs.inc

SERIAL_CONSOLE = "115200 ttyS5"
USE_VT = "0"

KERNEL_DEVICETREE = "som-9x25-150es.dtb"
UBOOT_MACHINE = "som9x25_config"

SOM_NUMBER = "04"
BOOTSTRAP_REV = "00.000"
UBOOT_REV = "00.002"
KERNEL_REV = "00.001"
FILESYSTEM_REV = "00.000"
```

## meta-emac/conf/machine/soma5d35.conf
```bitbake
#@TYPE: Machine
#@NAME: SoM-A5D35

#@DESCRIPTION: Machine configuration for EMAC's Som-A5D35

MACHINE_FEATURES:append = " bigflash can wifi sound "

MACHINE_EXTRA_RDEPENDS:append = " linux-firmware-bcm43430 "
USE_VT = "0"

include conf/machine/include/atmel/emac-arm-at91.inc
include conf/machine/include/arm/armv7a/tune-cortexa5.inc

KERNEL_DEVICETREE = "som-a5d35-150es.dtb som-a5d35-112es.dtb"
UBOOT_MACHINE = "soma5d35_spiflash_config"

SOM_NUMBER = "06"
BOOTSTRAP_REV = "00.001"
UBOOT_REV = "00.001"
KERNEL_REV = "00.000"
FILESYSTEM_REV = "00.000"

DEFAULTTUNE = "cortexa5hf"
```
