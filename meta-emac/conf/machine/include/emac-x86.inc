## meta-emac/conf/machine/soma5d36.conf
```bitbake
#@TYPE: Machine
#@NAME: SoM-A5D36
#@DESCRIPTION: Machine configuration for EMAC's Som-A5d36.

MACHINE_EXTRA_RDEPENDS_append = " \
        wf111-driver \
        wf111-driver-tools \
        wf111-driver-fw \
        linux-firmware-sd8787 \
"

include conf/machine/include/emac-arm-at91.inc
include conf/machine/include/tune-cortexa5.inc

EXTRA_IMAGEDEPENDS_remove =  "u-boot-emac-at91"

KERNEL_DEVICETREE = " \
    som-a5d36-200gs.dtb \
    som-a5d36-215gs.dtb \
    som-a5d36-250gs.dtb \
"

UBOOT_MACHINE = " \
    soma536mp_spiflash_config \
    soma5d36m_spiflash_config \
"

SPL_BINARY = "spl/boot.bin"

SOM_NUMBER = "07"
UBOOT_REV = "01.000"
KERNEL_REV = "00.000"
FILESYSTEM_REV = "00.000"

MACHINEOVERRIDES = "arm:armv7a:sama5:sama5d3:soma5d36"

DEFAULTTUNE = "cortexa5thf"

PREFERRED_PROVIDER_virtual/kernel =  "linux-emac"
PREFERRED_VERSION_linux-emac = "4.19%"
PREFERRED_PROVIDER_virtual/bootloader = "u-boot-emac"
EXTRA_IMAGEDEPENDS = " u-boot-emac linux-emac "
```

## meta-emac/conf/machine/soma5d36mp.conf
```bitbake
#@TYPE: Machine
#@NAME: Soma5d36mp
#@DESCRIPTION: Machine configuration for soma5d36 m/p.

include conf/machine/soma5d36.conf

MACHINE_EXTRA_RDEPENDS_remove = " \
    wf111-driver \
    wf111-driver-tools \
    wf111-driver-fw \
    linux-firmware-sd8787 \
"

MACHINE_FEATURES_append = " mtd "
MACHINE_FEATURES_remove = "wifi sound"

MACHINEOVERRIDES_append = ":soma5d36mp"

UBOOT_MACHINE = "soma536mp_spiflash_config"

SERIAL_CONSOLE = "115200 ttyS0"
USE_VT = "0"

PREFERRED_PROVIDER_virtual/kernel =  "linux-stable-rt"
PREFERRED_VERSION_linux-stable-rt = "5.10%"

KERNEL_DEVICETREE = " \
    som-a536mp-215gs.dtb \
"

EXTRA_IMAGEDEPENDS = " u-boot-emac linux-stable-rt "
```

## meta-emac/conf/machine/somimx6-rt.conf
```bitbake
#@TYPE: Machine
#@NAME: SoMIMX6-Xenomai

#@DESCRIPTION: Machine configuration for EMAC's SoM-imx6 with Xenomai

include conf/machine/somimx6.conf

MACHINE_FEATURES += "rt"

PREFERRED_PROVIDER:virtual/kernel = "linux-emac-rt"
PREFERRED_VERSION:linux-xenomai = "4.9%"
```

## meta-emac/conf/machine/somimx6-xenomai.conf
```bitbake
#@TYPE: Machine
#@NAME: SoMIMX6-Xenomai

#@DESCRIPTION: Machine configuration for EMAC's SoM-imx6 with Xenomai

include conf/machine/include/nxp/emac-imx6.conf

PREFERRED_PROVIDER_virtual/kernel = "linux-xenomai"
PREFERRED_VERSION_linux-xenomai = "4.9.95-ipipe%"
```

## meta-emac/conf/machine/vdx-632x-xenomai.conf
```bitbake
#@TYPE: Machine
#@NAME: VDX-632x-xenomai

#@DESCRIPTION: Machine configuration for VDX-632x with xenomai support.

PREFERRED_PROVIDER_virtual/kernel = "linux-xenomai"
PREFERRED_VERSION_linux-xenomai = "3.18-ipipe"

MACHINE_EXTRA_RDEPENDS:append = " xenomai-3 rtdm-gpio-driver "

include conf/machine/include/x86/emac-x86.inc
include conf/machine/include/x86/emac-x11.inc
include conf/machine/include/x86/tune-i586.inc

RESOLUTION = "1024x768"
MACHINE_NUMBER = "001"

GRUB_GFXMODE = "792"
```

## meta-emac/conf/machine/vortex-sbc.conf
```bitbake
#@TYPE: Machine
#@NAME: Vortex-SIB

#@DESCRIPTION: Machine configuration for Vortex SIB/SBC.
## WARNING 
# No openGL will not work with browsers
# https://www.vortex86.com/news/2

include conf/machine/include/x86/emac-x86.inc
include conf/machine/include/x86/emac-x11.inc
include conf/machine/include/x86/tune-i586.inc

RESOLUTION = "1024x768"
MACHINE_NUMBER = "S12"
KERNEL_REV = "00.000"
FILESYSTEM_REV = "00.000"

GRUB_GFXMODE = "792"
```
