## meta-emac/conf/distro/emac.conf
```bitbake
######################
## INCLUDES
######################
include conf/distro/poky.conf
include conf/distro/include/default-emac-providers.inc
include conf/distro/include/default-emac-versions.inc

######################
## BASIC INFO
######################

IMAGE_LINGUAS = "en-us"
DISTRO = "emac"
DISTRO_NAME = "EMAC OpenEmbedded Linux"
DISTRO_CODENAME =  "spike"
MAINTAINER = "EMAC <support@emacinc.com>"

RELEASE_DATE = "Unreleased"

MAJOR_DISTRO_VERSION = "6"
MINOR_DISTRO_VERSION = "0"
PATCH_DISTRO_VERSION = "0"

DISTRO_VERSION = "${MAJOR_DISTRO_VERSION}.${MINOR_DISTRO_VERSION}.${PATCH_DISTRO_VERSION}"
DISTRO_RELEASE = "Unstable"


######################
## DISTRO BASED FEATURES
######################
## FIXME ADD the following webengine    pcmcia
## x86 arm touchs sound mtd screen can pci rt
DISTRO_FEATURES = " \
    bluez5 \
    bluetooth \
    can \
    gstreamer \
    ipv4 ipv6 \
    ldconfig \
    mtd \
    pam \
    usrmerge \
    usbgadget usbhost \
    wifi \
    ${@bb.utils.contains('EMAC_DISPLAY_HW', 'opengl', ' opengl', '', d )} \
    ${@bb.utils.contains('EMAC_DISPLAY_HW', 'vulkan', ' vulkan', '', d )} \
    ${@bb.utils.contains('EMAC_AUDIOMANAGER', 'alsa', ' alsa', ' ', d )} \
    ${@bb.utils.contains('EMAC_AUDIOMANAGER', 'pulseaudio', ' pulseaudio', ' ', d )} \
    ${@bb.utils.contains('EMAC_INITMANAGER', 'systemd', ' systemd', ' sysvinit', d )} \
    ${@bb.utils.contains('EMAC_DISPLAY', 'linuxfb', ' linuxfb directfb ', '', d )} \
    ${@bb.utils.contains('EMAC_DISPLAY', 'x11', ' x11 xattr', '', d )} \
    ${@bb.utils.contains('EMAC_DISPLAY', 'wayland', ' wayland', '', d )} \
"



######################
## INIT MANAGMENT
######################
INIT_MANAGER = "${@bb.utils.contains('EMAC_INITMANAGER', 'systemd', 'systemd', 'sysvinit', d )}"
VIRTUAL-RUNTIME_init_manager = "${@bb.utils.contains('EMAC_INITMANAGER', 'systemd', 'systemd', 'sysvinit', d )}"
VIRTUAL-RUNTIME_dev_manager = "${@bb.utils.contains('EMAC_INITMANAGER', 'systemd', 'systemd', '', d )}"
VIRTUAL-RUNTIME_initscripts = "${@bb.utils.contains('EMAC_INITMANAGER', 'systemd', 'systemd-compat-units', 'initscripts', d )}"
VIRTUAL-RUNTIME_syslog = "${@bb.utils.contains('EMAC_INITMANAGER', 'systemd', '', 'sysklogd', d )}"
DISTRO_FEATURES_BACKFILL_CONSIDERED:append = "${@bb.utils.contains('EMAC_INITMANAGER','systemd',' sysvinit ',' systemd ', d )}"

######################
## SHELL MANAGEMENT
######################
VIRTUAL-RUNTIME_base-utils = "${@bb.utils.contains('EMAC_SHELLMANAGER', 'busybox', 'busybox', 'coreutils', d )}"
VIRTUAL-RUNTIME_base-utils-hwclock = "${@bb.utils.contains('EMAC_SHELLMANAGER', 'busybox', 'busybox-hwclock', 'util-linux-hwclock', d )}"
VIRTUAL-RUNTIME_base-utils-syslog ="${@bb.utils.contains('EMAC_SHELLMANAGER', 'busybox', 'busybox-syslog', '', d )}"
VIRTUAL-RUNTIME_login_manager = "${@bb.utils.contains('EMAC_SHELLMANAGER', 'busybox', 'busybox', 'shadow-base', d )}"

######################
## PACKAGE MANAGEMENT
######################
VIRTUAL-RUNTIME_update-alternatives = "update-alternatives-opkg"

######################
# BACKFILL
######################
DISTRO_FEATURES_BACKFILL_CONSIDERED:append = " gobject-introspection-data "
MACHINE_FEATURES_BACKFILL_CONSIDERED:append = " qemu-usermode "

######################
## SDK
######################
TARGET_VENDOR = "-emac"
SDK_VENDOR = "-emacsdk"
SDK_NAME = "${MACHINE}-${DISTRO}-${SDK_ARCH}-toolchain-${DISTRO_VERSION}-${TUNE_PKGARCH}"
SDK_VERSION = "${MAJOR_DISTRO_VERSION}.${MINOR_DISTRO_VERSION}"
SDKPATHINSTALL  = "/opt/${DISTRO}/${SDK_VERSION}-${MACHINE}-${TUNE_PKGARCH}"


######################
## MISC SETTINGS
######################
TOOLCHAIN_OUTPUTNAME ?= "${SDK_NAME}"
BB_SIGNATURE_HANDLER ?= 'OEBasicHash'
FONTCONFIG_CACHE_DIR = "${libdir}/fontconfig/cache"

######################
## LICENSE_STUFF
######################
LICENSE_CREATE_PACKAGE = "1"
COPY_LIC_MANIFEST = "0"

LICENSE_FLAGS_ACCEPTED:append = " \
    commercial_mpg123 \
    commercial_libav \
    commercial_x264 \
    commercial \
"

######################
## SANITY CHECKS
######################
PREMIRRORS ??= "\
bzr://.*/.*   http://downloads.yoctoproject.org/mirror/sources/ \n \
cvs://.*/.*   http://downloads.yoctoproject.org/mirror/sources/ \n \
git://.*/.*   http://downloads.yoctoproject.org/mirror/sources/ \n \
hg://.*/.*    http://downloads.yoctoproject.org/mirror/sources/ \n \
osc://.*/.*   http://downloads.yoctoproject.org/mirror/sources/ \n \
p4://.*/.*    http://downloads.yoctoproject.org/mirror/sources/ \n \
svn://.*/.*   http://downloads.yoctoproject.org/mirror/sources/ \n"

MIRRORS:append = " \
ftp://.*/.*      http://downloads.yoctoproject.org/mirror/sources/ \n \
http://.*/.*     http://downloads.yoctoproject.org/mirror/sources/ \n \
https://.*/.*    http://downloads.yoctoproject.org/mirror/sources/ \n"

CONNECTIVITY_CHECK_URIS ?= " \
     https://eula-downloads.yoctoproject.org/index.php \
     http://bugzilla.yoctoproject.org/report.cgi \
"


######################
## QA
######################
# QA check settings - a little stricter than the OE-Core defaults
WARN_QA = "textrel files-invalid incompatible-license xorg-driver-abi libdir \
           unknown-configure-option version-going-backwards"
ERROR_QA = "dev-so debug-deps dev-deps debug-files arch pkgconfig la perms \
            useless-rpaths rpaths staticdev ldflags pkgvarcheck already-stripped \
            compile-host-path dep-cmp installed-vs-shipped install-host-path \
            packages-list perm-config perm-line perm-link pkgv-undefined \
            pn-overrides split-strip var-undefined"
            

#######################################
## EXTRA INCLUDE PRE MACHINE BASED
## This is optional but really helps
## when dealing with vendor code (nxp,tegra,ect)
#######################################
    
```

## meta-emac/conf/distro/include/default-emac-providers.inc
```bitbake
# Prefer libjpeg-turbo from meta-oe as it provides SIMD optimizations
PREFERRED_PROVIDER_jpeg ?= "libjpeg-turbo"
PREFERRED_PROVIDER_jpeg-native ?= "libjpeg-turbo-native"

# This line is required until all of the references to libjson are changed in metadata to json-c.
PREFERRED_PROVIDER_libjson = "json-c"


PREFERRED_PROVIDER_virtual/base-utils =   "${@bb.utils.contains('EMAC_SHELLMANAGER', 'busybox', 'busybox', 'coreutils', d )}"

PREFERRED_PROVIDER_virtual/update-alternatives = "${@bb.utils.contains('EMAC_PACKAGEMANAGER', 'deb', 'dpkg', 'opkg-utils', d )}"
PREFERRED_PROVIDER_virtual/update-alternatives-native = "${@bb.utils.contains('EMAC_PACKAGEMANAGER', 'deb', 'dpkg-native', 'opkg-utils-native', d )}"
```

## meta-emac/conf/distro/include/machine/soma5d36.conf
```bitbake
DISTRO_FEATURES_DEFAULT_remove = "irda pcmcia pci 3g nfc zeroconf x11 ext2"
DISTRO_FEATURES_remove = " opengl xattr x11 webengine wayland vulkan gobject-introspection-data"
DISTRO_FEATURES_FILTER_NATIVESDK_remove = " x11"
```

## meta-emac/conf/distro/include/machine/somimx6q-ha.conf
```bitbake
# So this device needs vivante and removal of the rest. 
# In other words this distro is set for fb support via gles only
 
DISTRO_FEATURES_DEFAULT:remove = "irda pcmcia pci 3g nfc zeroconf x11 ext2"
DISTRO_FEATURES:remove = "xattr x11 webengine vulkan gobject-introspection-data"

DISTRO_FEATURES_BACKFILL_CONSIDERED = " sysvinit "
DISTRO_FEATURES_FILTER_NATIVESDK:append = " x11"
DISTRO_FEATURES_FILTER_NATIVESDK:remove = " x11"

DISTRO_FEATURES = "ext4 \
    alsa \
    bluez5 \
    ipv4 \
    ipv6 \
    ldconfig \
    opengl \
    pulseaudio \
    usrmerge \
    gstreamer \
    keyboard \
"

# DISTRO_FEATURES_NATIVE = "x11 ipv6 xattr"
# DISTRO_FEATURES_NATIVESDK = "x11"

DISTRO_EXTRA_RDEPENDS = " \
    kernel-module-imx-gpu-viv \
    imx-gpu-viv \
    imx-codec \
    imx-gpu-g2d \
    libimxvpuapi \
    imx-vpu \
    imx-vpuwrap \
    libimxdmabuffer \
"

DISTRO_EXTRA_RRECOMMENDS = " \
    libimxdmabuffer \
    imx-gst1.0-plugin \
    gstreamer1.0-plugins-imx \
"

ACCEPT_FSL_EULA = "1"
LICENSE_FLAGS_WHITELIST = "commercial"
```

## meta-emac/conf/layer.conf
```bitbake
# We have a conf and classes directory, add to BBPATH
BBPATH =. "${LAYERDIR}:"

# We have recipes-* directories, add to BBFILES
BBFILES += "${LAYERDIR}/recipes-*/*/*.bb \
            ${LAYERDIR}/recipes-*/*/*.bbappend"

BBFILE_COLLECTIONS += "emac-core"
BBFILE_PATTERN_emac-core = "^${LAYERDIR}/"
BBFILE_PRIORITY_emac-core = "7"

LAYERSERIES_COMPAT_emac-core = "dunfell"

LAYERDEPENDS_emac-core = " \
    core \
    openembedded-layer \
    meta-python \
    networking-layer \
    multimedia-layer \
    filesystems-layer \
    perl-layer \
"

LICENSE_PATH += "${LAYERDIR}/licenses"
```

## meta-emac/conf/machine/aimb-214.conf
```bitbake
#@TYPE: Machine
#@NAME: AIMB-214

#@DESCRIPTION: Machine configuration for AIMB-214

include conf/machine/include/x86/emac-x86.inc
include conf/machine/include/x86/emac-x11.inc
include conf/machine/include/intel/tune-atom.inc

RESOLUTION = "1024x768"
```

## meta-emac/conf/machine/atom-sbc-32.conf
```bitbake
#@TYPE: Machine
#@NAME: Atom-SIB
#@DESCRIPTION: Machine configuration for core2-32(x86/i585/i386 )

TARGET_ARCH = "i.86"
DEFAULTTUNE = "core2-32"
MACHINEOVERRIDES =. "i.86:i386:atom-sbc-32"

include conf/machine/include/x86/emac-x11.inc
include conf/machine/include/intel/atom.inc

MACHINE_FEATURES += " touchscreen "

RESOLUTION = "1600x900 1024x600"
MACHINE_NUMBER = "S10"
KERNEL_REV = "00.000"
FILESYSTEM_REV = "00.000"
```

## meta-emac/conf/machine/atom-sbc-64-x32.conf
```bitbake
 #@TYPE: Machine
#@NAME: Atom-SIB
#@DESCRIPTION: Machine configuration for core2-64-x32(x86_64/i686 with 32 bit support)

DEFAULTTUNE = "core2-64-x32"
MACHINEOVERRIDES =. "x86_64:x86-64:atom-sbc-64"

include conf/machine/include/emac-x11.inc
include conf/machine/include/emac-x86.inc
include conf/machine/include/tune-core2.inc



#KERNEL_MODS_NEEDED = " \
#    kernel-module-*
#"



MACHINE_FEATURES += " \
    touchscreen \
    efi \
"

MACHINE_EXTRA_RDEPENDS += " \
    grub-efi \
    efibootmgr \
"


# KERNEL_MODULE_AUTOLOAD


RESOLUTION = "1280x1024"
MACHINE_NUMBER = "S10"
KERNEL_REV = "00.000"
FILESYSTEM_REV = "00.000"
```

## meta-emac/conf/machine/atom-sbc-64.conf
```bitbake
#@TYPE: Machine
#@NAME: Atom-SIB
#@DESCRIPTION: Machine configuration for core2-64(x86_64/i686)

DEFAULTTUNE = "core2-64"
MACHINEOVERRIDES =. "x86_64:x86-64:atom-sbc-64:"

include conf/machine/include/emac-x11.inc
include conf/machine/include/emac-x86.inc
include conf/machine/include/tune-core2.inc

MACHINE_FEATURES += " \
    touchscreen \
"

## SX
EMAC_CODE_ID ?= "SM"
## NNN
EMAC_OEVERSION ?= "055"
# ##
EMAC_PRODUCT_ID ?= "01"
# T
EMAC_PRODUCT_TYPE ?= "S"
## C
EMAC_CARRIRT_ID ?= "S"
## PP
EMAC_SBC_ID ?= "10"
## B
EMAC_ARCH ?= "X"
## RR
EMAC_REV ?= "00"
## VVV
EMAC_BOM ?= "000"


SOM_NUMBER = "S"
MACHINE_NUMBER = "S10"
RESOLUTION = "1280x1024"
KERNEL_REV = "00.000"
FILESYSTEM_REV = "00.000"
BOOTSTRAP_REV = "00.000"
UBOOT_REV = "00.000"
```

## meta-emac/conf/machine/atom-sbc-ia64.conf
```bitbake
#@TYPE: Machine
#@NAME: Atom-SIB-ia64
#@DESCRIPTION: Machine configuration for core2-64-x32(x86_64/i686 with binary emululation for 32 bit programs)

DEFAULTTUNE = "core2-64-x32"
MACHINEOVERRIDES =. "x86_64:x86-64:atom-sbc-ia64"

include conf/machine/include/emac-x11.inc
include conf/machine/include/intel/atom.inc

KERNEL_MODS_NEEDED = " \
    kernel-module-x86-x32 \
    kernel-module-ia32-emulation \
"

MACHINE_FEATURES += " touchscreen "
RESOLUTION = "1280x1024"
MACHINE_NUMBER = "S10"
KERNEL_REV = "00.000"
FILESYSTEM_REV = "00.000"
```

## meta-emac/conf/machine/atom-sbc.conf
```bitbake
#@TYPE: Machine
#@NAME: Atom-SIB
#@DESCRIPTION: Machine configuration for core2-32(x86/i686 )

include conf/machine/include/emac-x11.inc
include conf/machine/include/emac-x86.inc

DEFAULTTUNE ?= "core2-32"
MACHINEOVERRIDES =. "x86:i386:atom-sbc:"

include conf/machine/include/tune-core2.inc

MACHINE_FEATURES += " \
    touchscreen \
    efi \
"

MACHINE_EXTRA_RDEPENDS += " \
    grub-efi \
    efibootmgr \
    kernel-module-susicores \
    susi-utils \
"

RESOLUTION = "1600x900 1024x600"
MACHINE_NUMBER = "S10"
KERNEL_REV = "00.000"
FILESYSTEM_REV = "00.000"
```

## meta-emac/conf/machine/ft10270.conf
```bitbake
#@TYPE: Machine
#@NAME: FT10270

#@DESCRIPTION: Machine configuration for Faytech 10270

include conf/machine/include/x86/emac-x86.inc
include conf/machine/include/x86/emac-x11.inc
include conf/machine/include/intel/tune-atom.inc

MACHINE_FEATURES:append = " touchscreen"
MACHINE_EXTRA_RDEPENDS:append = " xf86-video-ati linux-firmware-iwlwifi-4965-2 linux-firmware-radeon"

RESOLUTION = "1024x768"
```

## meta-emac/conf/machine/hmi-043t.conf
```bitbake
#@TYPE: Machine
#@NAME: HMI-043T

#@DESCRIPTION: Machine configuration for HMI-043T

MACHINE_FEATURES += " touchscreen can "
MACHINE_FEATURES_remove = "efi"

include conf/machine/include/emac-x86.inc
include conf/machine/include/emac-x11.inc
include conf/machine/include/tune-i586.inc

## KERNEL
PREFERRED_VERSION_linux-emac = "4.9%"

## BOOTLOADER 
PREFERRED_PROVIDER_virtual/bootloader ?= "grub"
MACHINE_EXTRA_RDEPENDS += "grub"
MACHINE_EXTRA_RDEPENDS_remove = "grub-efi efibootmgr"
GRUB_GFXMODE = "8"

IMAGE_FSTYPES = "tar.gz"

RESOLUTION = "480x272"
MACHINE_NUMBER = "000"
```

## meta-emac/conf/machine/include/arm/armv7a/som3517.conf
```bitbake
#@TYPE: Machine
#@NAME: SoM3517

#@DESCRIPTION: Machine configuration for EMAC's SoM-3517

PREFERRED_VERSION:linux-emac = "4.9%"
MACHINE_FEATURES:append  = " bigflash can screen touchscreen sound wifi "
MACHINE_EXTRA_RDEPENDS:append = " wf111-driver wf111-driver-tools wf111-driver-fw linux-firmware-sd8787 "

include conf/machine/include/ti/emac-omap.inc
include conf/machine/include/arm/armv7a/tune-cortexa8.inc

SERIAL_CONSOLE = "115200 ttyO2"

KERNEL_DEVICETREE = " \
	som-3517-210es.dtb \
	som-3517-212es.dtb \
	som-3517-250gs-7.dtb \
"

SPL_BINARY = "MLO"
UBOOT_MACHINE = "som3517_config"
UBOOT_SUFFIX = "img"

SOM_NUMBER = "09"
BOOTSTRAP_REV = "00.000"
UBOOT_REV = "00.000"
KERNEL_REV = "00.000"
FILESYSTEM_REV = "00.000"
```

## meta-emac/conf/machine/include/arm/armv7a/soma5d36.conf
```bitbake
#@TYPE: Machine
#@NAME: SoM-A5D36

#@DESCRIPTION: Machine configuration for EMAC's Som-A5d36.

PREFERRED_VERSION:linux-emac ?= "4.19%"
PREFERRED_PROVIDER:virtual/bootloader = "u-boot-emac"
MACHINE_FEATURES:append = " bigflash can screen touchscreen wifi sound "
MACHINE_EXTRA_RDEPENDS:append = " wf111-driver wf111-driver-tools wf111-driver-fw linux-firmware-sd8787 "
EXTRA_IMAGEDEPENDS:append =  " u-boot-emac "

include conf/machine/include/atmel/emac-arm-at91.inc
include conf/machine/include/soc-family.inc
include conf/machine/include/arm/armv7a/tune-cortexa5.inc

KERNEL_DEVICETREE = "som-a5d36-200gs.dtb som-a5d36-215gs.dtb som-a5d36-250gs.dtb som-a536mp-215gs.dtb"
UBOOT_MACHINE = "soma536mp_spiflash_config soma5d36m_spiflash_config"
SPL_BINARY = "spl/boot.bin"

SOM_NUMBER = "07"
UBOOT_REV = "01.000"
KERNEL_REV = "00.000"
FILESYSTEM_REV = "00.000"

SOC="Atmel"
SOC_FAMILY = "sama5:sama5d3"
MACHINEOVERRIDES =. "arm:soma5d36:"
DEFAULTTUNE = "cortexa5hf"
```

## meta-emac/conf/machine/include/arm/armv7a/somimx6-xenomai.conf
```bitbake
#@TYPE: Machine
#@NAME: SoMIMX6-Xenomai

#@DESCRIPTION: Machine configuration for EMAC's SoM-imx6 with Xenomai

include conf/machine/include/arm/armv7a/emac-imx6.conf

PREFERRED_PROVIDER:virtual/kernel = "linux-xenomai"
PREFERRED_VERSION:linux-xenomai = "4.9.95-ipipe%"
```
