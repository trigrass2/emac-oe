## meta-emac/conf/machine/include/arm/armv7a/somimx6.conf
```bitbake
#@TYPE: Machine
#@NAME: SoMIMX6

#@DESCRIPTION: Machine configuration for EMAC's SoM-imx6

RESOLUTION = "800x480 1024x600"

MACHINE_FEATURES:append = " pci can wifi sound bigflash screen touchscreen "
# MACHINE_EXTRA_RDEPENDS:append = " linux-firmware-wl18xx "

include conf/machine/include/soc-family.inc
include conf/machine/include/nxp/emac-imx6.inc
include conf/machine/include/arm/armv7a/tune-cortexa9.inc

KERNEL_DEVICETREE ??= " \
	som-imx6q-350es.dtb \
	som-imx6q-350es-10.dtb \
"

SOM_NUMBER = "11"
BOOTSTRAP_REV = "00.001"
UBOOT_REV = "00.001"
KERNEL_REV = "00.000"
FILESYSTEM_REV = "00.000"


SOC_FAMILY = "mx6:mx6q:mx6dl:"
MACHINEOVERRIDES:prepend = "arm:"
DEFAULTTUNE = "cortexa9thf-neon"
```

## meta-emac/conf/machine/include/arm/armv7a/somimx6ul.conf
```bitbake
#@TYPE: Machine
#@NAME: SoMIMX6UL

#@DESCRIPTION: Machine configuration for EMAC's SoM-imx6ul

MACHINE_FEATURES:append = " pci can wifi sound bigflash can "

include conf/machine/include/nxp/emac-imx6.inc
include conf/machine/include/arm/armv7a/tune-cortexa7.inc

SERIAL_CONSOLE = "115200 ttymxc4"
USE_VT = "0"
MACHINE_EXTRA_RDEPENDS:append = " linux-firmware-bcm43430 "

KERNEL_DEVICETREE = " \
	som-imx6ul-150es.dtb \
	som-imx6ul-112es.dtb \
"
UBOOT_MACHINE = "somimx6ul_defconfig"

SOM_NUMBER = "10"
BOOTSTRAP_REV = "00.000"
UBOOT_REV = "00.000"
KERNEL_REV = "00.000"
FILESYSTEM_REV = "00.000"


SOC_FAMILY = "mx6:mx6ull"
MACHINEOVERRIDES:prepend = "arm:mx6:mx6ull:"
DEFAULTTUNE = "cortexa7thf-neon"
```

## meta-emac/conf/machine/include/atmel/emac-arm-at91.inc
```bitbake
PREFERRED_PROVIDER:virtual/kernel ?= "linux-emac"
PREFERRED_VERSION:linux-emac ?= "4.9%"
PREFERRED_PROVIDER:virtual/bootloader ?= "u-boot-emac-at91"

PREFERRED_PROVIDER:virtual/xserver ?= "xserver-xorg"
XSERVER ?= " \
    xserver-xorg \
    xserver-xorg-extension-dri2 \
    xserver-xorg-extension-glx \
    xserver-xorg-extension-extmod \
    xserver-xorg-extension-dbe \
    xf86-input-mouse \
    xf86-input-keyboard \
    xf86-input-evdev \
    xf86-video-fbdev \
    xf86-input-tslib \
"

MACHINE_FEATURES:append = " arm "

SERIAL_CONSOLE ?= "115200 ttyS0"

KERNEL_IMAGETYPE ?= "zImage"

UBOOT_ENTRYPOINT ?= "0x70008000"
UBOOT_MACHINE ?= "som9x25_config"

IMAGE_FSTYPES ?= "tar.gz"
```

## meta-emac/conf/machine/include/emac-arm-at91.inc
```bitbake
PREFERRED_PROVIDER_virtual/kernel ?= "linux-emac"
PREFERRED_VERSION_linux-emac ?= "4.9%"
PREFERRED_PROVIDER_virtual/bootloader ?= "u-boot-emac-at91"

PREFERRED_PROVIDER_virtual/xserver ?= "xserver-xorg"
XSERVER ?= "xserver-xorg \
           xserver-xorg-extension-dri2 \
           xserver-xorg-extension-glx \
           xserver-xorg-extension-extmod \
           xserver-xorg-extension-dbe \
           xf86-input-mouse \
           xf86-input-keyboard \
           xf86-input-evdev \
	   xf86-video-fbdev \
           xf86-input-tslib \
	   "

MACHINE_FEATURES += "wifi sound arm"
EXTRA_IMAGEDEPENDS += "u-boot-emac-at91 at91bootstrap"

SERIAL_CONSOLE ?= "115200 ttyS0"

KERNEL_IMAGETYPE ?= "zImage"

UBOOT_ENTRYPOINT ?= "0x70008000"
UBOOT_MACHINE ?= "som9x25_config"

IMAGE_FSTYPES ?= "tar.gz"
```

## meta-emac/conf/machine/include/emac-arma8.inc
```bitbake
PREFERRED_PROVIDER_virtual/kernel = "linux-emac-omap"
PREFERRED_VERSION_linux-emac-omap ?= "4.0%"
PREFERRED_PROVIDER_virtual/bootloader = "u-boot-emac-omap"


PREFERRED_PROVIDER_virtual/xserver = "xserver-xorg"
XSERVER = "xserver-xorg \
           xserver-xorg-extension-dri2 \
           xserver-xorg-extension-glx \
           xserver-xorg-extension-extmod \
           xserver-xorg-extension-dbe \
           xf86-input-evdev \
           xf86-input-mouse \
           xf86-video-omapfb \
	   xf86-video-fbdev \
           xf86-input-keyboard \
           xf86-input-tslib \
"

MACHINE_FEATURES += "screen usbhost apm sound serial touch usbgadget can"
MACHINE_EXTRA_RDEPENDS += "u-boot-fw-utils"
EXTRA_IMAGEDEPENDS += "u-boot-emac-omap"

SERIAL_CONSOLE ?= "115200 ttyO0"

KERNEL_IMAGETYPE ?= "zImage"

UBOOT_ENTRYPOINT ?= "0x80008000"
UBOOT_MACHINE ?= "am3517_evm_config"

IMAGE_FSTYPES ?= "tar.gz"
```

## meta-emac/conf/machine/include/emac-imx6.inc
```bitbake
PREFERRED_PROVIDER_virtual/kernel ?= "linux-emac"
PREFERRED_VERSION_linux-emac ?= "4.9%"
PREFERRED_PROVIDER_virtual/bootloader = "u-boot-emac"

PREFERRED_PROVIDER_virtual/xserver ?= "xserver-xorg"
XSERVER ?= "xserver-xorg \
           xserver-xorg-extension-dri2 \
           xserver-xorg-extension-glx \
           xserver-xorg-extension-extmod \
           xserver-xorg-extension-dbe \
           xf86-input-evdev \
           xf86-input-mouse \
           xf86-video-omapfb \
	   xf86-video-fbdev \
           xf86-input-keyboard \
           xf86-input-tslib \
"

MACHINE_FEATURES += "pci usbhost sound serial can"
MACHINE_EXTRA_RDEPENDS += "u-boot-fw-utils kernel-devicetree"
EXTRA_IMAGEDEPENDS += "u-boot-emac"

SERIAL_CONSOLE ?= "115200 ttymxc1"

KERNEL_IMAGETYPE ?= "zImage"

EMAC_LINUX_VERSION_EXTENSION ?= "_${EMAC_LINUX_VERSION}X${SOM_NUMBER}A${KERNEL_REV}.zimg"

UBOOT_SUFFIX = "imx"
UBOOT_MACHINE ?= "somimx6dq_config"

IMAGE_FSTYPES ?= "tar.gz"

DEFAULTTUNE = "armv7a-neon"
```

## meta-emac/conf/machine/include/emac-omap.inc
```bitbake
PREFERRED_PROVIDER_virtual/kernel ?= "linux-emac"
PREFERRED_VERSION_linux-emac ?= "4.19%"
PREFERRED_PROVIDER_virtual/bootloader ?= "u-boot-emac"
PREFERRED_VERSION_u-boot-emac ?= "v2020.04%"

PREFERRED_PROVIDER_virtual/xserver = "xserver-xorg"

XSERVER = "\
    xserver-xorg \
    xserver-xorg-extension-dri2 \
    xserver-xorg-extension-glx \
    xserver-xorg-extension-extmod \
    xserver-xorg-extension-dbe \
    xf86-input-evdev \
    xf86-input-mouse \
    xf86-video-omapfb \
    xf86-video-fbdev \
    xf86-input-keyboard \
    xf86-input-tslib \
"

MACHINE_FEATURES += "arm"
SERIAL_CONSOLE ?= "115200 ttyO0"
KERNEL_IMAGETYPE ?= "zImage"
UBOOT_MACHINE ?= "am3517_evm_config"
IMAGE_FSTYPES ?= "tar.gz"
```

## meta-emac/conf/machine/include/emac-x11.inc
```bitbake
### X11
PREFERRED_PROVIDER_virtual/xserver ?= "xserver-xorg"

XSERVER ?= "\
    ${XSERVER_X86_BASE} \
    ${XSERVER_X86_EXT} \
    ${XSERVER_X86_I915} \
    ${XSERVER_X86_I965} \
    ${XSERVER_X86_FBDEV} \
    ${XSERVER_X86_VESA} \
    ${XSERVER_X86_MODESETTING} \
    ${XSERVER_X86_TOUCH} \
"

XSERVER_X86_BASE = " \
    xserver-xorg \
    xf86-input-mouse \
    xf86-input-keyboard \
    xf86-input-evdev \
    xf86-input-synaptics \
"

XSERVER_X86_EXT = " \
    ${@bb.utils.contains('DISTRO_FEATURES', 'opengl', 'xserver-xorg-extension-glx', '', d)} \
    xserver-xorg-module-libint10 \
"

XSERVER_X86_I915 = "xf86-video-intel \
    ${@bb.utils.contains('DISTRO_FEATURES', 'opengl', 'mesa-driver-i915', '', d)} \
"

XSERVER_X86_I965 = "xf86-video-intel \
    ${@bb.utils.contains('DISTRO_FEATURES', 'opengl', 'mesa-driver-i965', '', d)} \
"

XSERVER_X86_VESA = "xf86-video-vesa"
XSERVER_X86_FBDEV = "xf86-video-fbdev"

XSERVER_X86_TOUCH = " \
    ${@bb.utils.contains('MACHINE_FEATURES', 'touchscreen', 'xf86-input-tslib', '', d)} \
"

XSERVER_X86_MODESETTING = "xf86-video-modesetting"
 
```
