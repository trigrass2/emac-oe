## meta-emac-bsp/vendor-layers/texas-instruments/recipes-bsp/u-boot/u-boot-ti-staging/som-5728m/emac-sources/configs/emac-som-5728m_defconfig
```kconfig
CONFIG_ARM=y
CONFIG_ARCH_OMAP2PLUS=y
CONFIG_SYS_MALLOC_F_LEN=0x18000
CONFIG_TI_COMMON_CMD_OPTIONS=y
CONFIG_NR_DRAM_BANKS=2
CONFIG_HAS_CUSTOM_SYS_INIT_SP_ADDR=y
CONFIG_CUSTOM_SYS_INIT_SP_ADDR=0x4037fef0
CONFIG_DM_GPIO=y
CONFIG_SPL_DM_SPI=y
CONFIG_DEFAULT_DEVICE_TREE="emac-som-5728m-350es"
CONFIG_SPL_TEXT_BASE=0x40300000
CONFIG_OMAP54XX=y
CONFIG_SYS_PROMPT=">>> "
CONFIG_TARGET_EMAC_SOM_5728M=y
CONFIG_DM_RESET=y
CONFIG_BOOTCOUNT_BOOTLIMIT=5
CONFIG_SPL_SIZE_LIMIT=0x80000
CONFIG_SPL=y
CONFIG_ARMV7_LPAE=y
CONFIG_CMD_HDMIDETECT=y
CONFIG_ENV_ADDR=0xC0000
CONFIG_SPL_PAYLOAD="u-boot.img"
CONFIG_AHCI=y
CONFIG_PHYS_64BIT=y
# CONFIG_FIT is not set
CONFIG_OF_BOARD_SETUP=y
CONFIG_OF_STDOUT_VIA_ALIAS=y
CONFIG_DISTRO_DEFAULTS=y
CONFIG_QSPI_BOOT=y
CONFIG_SATA_BOOT=y
CONFIG_SD_BOOT=y
CONFIG_SPI_BOOT=y
CONFIG_AUTOBOOT_USE_MENUKEY=y
CONFIG_AUTOBOOT_MENUKEY=120
CONFIG_USE_BOOTARGS=y
CONFIG_DEFAULT_FDT_FILE="emac-som-5728m-350es.dtb"
CONFIG_SYS_CONSOLE_ENV_OVERWRITE=y
CONFIG_SYS_CONSOLE_INFO_QUIET=y
CONFIG_LOGF_FILE=y
CONFIG_LOGF_LINE=y
CONFIG_LOGF_FUNC=y
CONFIG_SPL_LOG=y
CONFIG_LOG_ERROR_RETURN=y
CONFIG_BOARD_TYPES=y
CONFIG_DISPLAY_BOARDINFO_LATE=y
CONFIG_BOARD_EARLY_INIT_F=y
CONFIG_SPL_BOOTCOUNT_LIMIT=y
CONFIG_SPL_SYS_MALLOC_SIMPLE=y
# CONFIG_SYS_MMCSD_RAW_MODE_U_BOOT_USE_SECTOR is not set
CONFIG_SPL_DMA=y
CONFIG_SPL_SAVEENV=y
CONFIG_SPL_FAT_WRITE=y
# CONFIG_SPL_NAND_SUPPORT is not set
CONFIG_SPL_NAND_ECC=y
CONFIG_SPL_DM_SPI_FLASH=y
CONFIG_SPL_PCI=y
CONFIG_SPL_DM_RESET=y
CONFIG_SPL_RAM_SUPPORT=y
CONFIG_SPL_REMOTEPROC=y
CONFIG_SPL_USB_GADGET=y
CONFIG_CMD_CONFIG=y
# CONFIG_BOOTM_NETBSD is not set
# CONFIG_BOOTM_PLAN9 is not set
# CONFIG_BOOTM_RTEMS is not set
# CONFIG_BOOTM_VXWORKS is not set
CONFIG_CMD_BOOTEFI_HELLO=y
CONFIG_CMD_BOOTMENU=y
# CONFIG_CMD_ELF is not set
# CONFIG_CMD_IMI is not set
# CONFIG_CMD_XIMG is not set
CONFIG_CMD_GREPENV=y
CONFIG_CMD_ENV_CALLBACK=y
CONFIG_CMD_ENV_FLAGS=y
CONFIG_CMD_NVEDIT_EFI=y
CONFIG_CMD_NVEDIT_INFO=y
CONFIG_CRC32_VERIFY=y
# CONFIG_CMD_EEPROM is not set
CONFIG_CMD_MD5SUM=y
CONFIG_MD5SUM_VERIFY=y
CONFIG_CMD_MEMINFO=y
# CONFIG_CMD_DFU is not set
CONFIG_CMD_DM=y
# CONFIG_CMD_FLASH is not set
CONFIG_CMD_GPT_RENAME=y
CONFIG_CMD_LSBLK=y
CONFIG_CMD_CLONE=y
CONFIG_CMD_PCI=y
CONFIG_CMD_SF_TEST=y
CONFIG_CMD_USB_MASS_STORAGE=y
CONFIG_BOOTP_DNS2=y
CONFIG_CMD_TFTPSRV=y
CONFIG_CMD_WGET=y
CONFIG_CMD_DNS=y
CONFIG_CMD_LINK_LOCAL=y
CONFIG_CMD_BOOTCOUNT=y
CONFIG_CMD_EXCEPTION=y
CONFIG_CMD_SOUND=y
CONFIG_CMD_AES=y
CONFIG_CMD_HASH=y
CONFIG_HASH_VERIFY=y
CONFIG_CMD_DIAG=y
CONFIG_CMD_LOG=y
CONFIG_OF_CONTROL=y
CONFIG_SPL_OF_CONTROL=y
CONFIG_OF_SPL_REMOVE_PROPS="clocks clock-names interrupt-parent"
CONFIG_ENV_OVERWRITE=y
CONFIG_ENV_IS_IN_SPI_FLASH=y
CONFIG_ENV_FAT_INTERFACE="mmcblk1"
CONFIG_ENV_FAT_DEVICE_AND_PART="1:1"
CONFIG_SYS_RELOC_GD_ENV_ADDR=y
CONFIG_SYS_MMC_ENV_DEV=1
CONFIG_SYS_MMC_ENV_PART=1
CONFIG_USE_DEFAULT_ENV_FILE=y
CONFIG_DEFAULT_ENV_FILE="u-boot-default.txt"
CONFIG_ENV_VARS_UBOOT_RUNTIME_CONFIG=y
CONFIG_VERSION_VARIABLE=y
CONFIG_BOOTP_SEND_HOSTNAME=y
CONFIG_NET_RANDOM_ETHADDR=y
CONFIG_NETCONSOLE=y
CONFIG_SPL_DM=y
CONFIG_SPL_DM_DEVICE_REMOVE=y
CONFIG_SPL_DM_SEQ_ALIAS=y
CONFIG_SPL_REGMAP=y
CONFIG_SPL_SYSCON=y
CONFIG_SPL_OF_TRANSLATE=y
CONFIG_DWC_AHCI=y
CONFIG_BOOTCOUNT_LIMIT=y
CONFIG_BOOTCOUNT_ENV=y
CONFIG_BUTTON=y
CONFIG_BUTTON_GPIO=y
CONFIG_PCF8575_GPIO=y
CONFIG_DM_I2C=y
CONFIG_DM_KEYBOARD=y
CONFIG_LED=y
CONFIG_MISC=y
CONFIG_SUPPORT_EMMC_BOOT=y
CONFIG_MMC_IO_VOLTAGE=y
CONFIG_MMC_UHS_SUPPORT=y
CONFIG_MMC_HS200_SUPPORT=y
CONFIG_SPL_MMC_HS200_SUPPORT=y
CONFIG_MMC_OMAP_HS=y
CONFIG_MTD=y
CONFIG_DM_SPI_FLASH=y
CONFIG_SF_DEFAULT_MODE=0
CONFIG_SF_DEFAULT_SPEED=76800000
CONFIG_SPI_FLASH_WINBOND=y
CONFIG_PHY_ATHEROS=y
CONFIG_PHY_MICREL=y
CONFIG_PHY_MICREL_KSZ8XXX=y
CONFIG_PHY_TI_DP83867=y
CONFIG_PHY_FIXED=y
CONFIG_DM_MDIO=y
CONFIG_DM_ETH_PHY=y
CONFIG_PHY_GIGE=y
CONFIG_RGMII=y
CONFIG_MII=y
CONFIG_DRIVER_TI_CPSW=y
CONFIG_PCI=y
CONFIG_SPL_PHY=y
CONFIG_PIPE3_PHY=y
CONFIG_OMAP_USB2_PHY=y
CONFIG_PHY_CADENCE_SIERRA=y
CONFIG_PINCTRL=y
CONFIG_DM_PMIC=y
CONFIG_PMIC_PALMAS=y
CONFIG_DM_REGULATOR=y
CONFIG_DM_REGULATOR_FIXED=y
CONFIG_DM_REGULATOR_GPIO=y
CONFIG_DM_REGULATOR_PALMAS=y
CONFIG_PALMAS_POWER=y
CONFIG_DM_PWM=y
CONFIG_RESET_DRA7=y
CONFIG_DM_SCSI=y
CONFIG_DM_SERIAL=y
CONFIG_SOUND=y
CONFIG_SPI=y
CONFIG_DM_SPI=y
CONFIG_TI_QSPI=y
CONFIG_TIMER=y
CONFIG_OMAP_TIMER=y
CONFIG_USB=y
CONFIG_DM_USB_GADGET=y
CONFIG_SPL_DM_USB_GADGET=y
CONFIG_USB_XHCI_HCD=y
CONFIG_USB_XHCI_DWC3=y
CONFIG_USB_DWC3=y
CONFIG_USB_DWC3_OMAP=y
CONFIG_USB_DWC3_GENERIC=y
CONFIG_USB_DWC3_PHY_OMAP=y
CONFIG_USB_GADGET=y
CONFIG_USB_GADGET_MANUFACTURER="Texas Instruments"
CONFIG_USB_GADGET_VENDOR_NUM=0x0451
CONFIG_USB_GADGET_PRODUCT_NUM=0xd022
CONFIG_USB_GADGET_DOWNLOAD=y
CONFIG_CC_OPTIMIZE_LIBS_FOR_SPEED=y
# CONFIG_SPL_USE_TINY_PRINTF is not set
CONFIG_SPL_LZO=y
CONFIG_SPL_SPI_FLASH_SUPPORT=y
CONFIG_SPL_SPI=y
CONFIG_SPL_SPI_FLASH_TINY=y
CONFIG_SPL_SPI_LOAD=y
CONFIG_SYS_SPI_U_BOOT_OFFS=0x10000
```

## meta-emac-bsp/vendor-layers/texas-instruments/recipes-bsp/u-boot/u-boot-ti-staging/som5728/src/board/emacinc/som5728/Kconfig
```kconfig
if TARGET_SOM5728

config SYS_BOARD
	default "som5728"

config SYS_VENDOR
	default "emacinc"

config SYS_CONFIG_NAME
	default "emac-som5728"

source "board/emacinc/common/Kconfig"

endif
```

## meta-emac-bsp/wic/genericx86-legacyboot.wks
```
# short-description: Create an EFI disk image for genericx86* that also supports Legacy Boot
# long-description: Creates a partitioned EFI disk image for genericx86* machines that need Legacy Boot
part /boot --source bootimg-biosplusefi --sourceparams="loader=grub-efi" --active --align 1024 --use-uuid
part / --source rootfs --ondisk sda --fstype=ext4 --label platform --align 1024 --use-uuid
part swap --ondisk sda --size 44 --label swap1 --fstype=swap

bootloader --ptable gpt --timeout=5 --append="rootfstype=ext4 console=ttyS0,115200 console=tty0"
```

## meta-emac-distro/conf/distro/emac-tiny.conf
```bitbake
include conf/distro/poky-tiny.conf 
DISTRO = "emac-tiny"
DISTROOVERRIDES = "poky:poky-tiny:emac:emac-tiny"
DISTRO_FEATURES = " pci ipv4 ipv6 usbhost "
INIT_MANAGER = "mdev-busybox"
IMAGE_FSTYPES = "cpio.gz tar.gz"
QB_DEFAULT_FSTYPE = "cpio.gz"


MAJOR_DISTRO_VERSION = "6"
MINOR_DISTRO_VERSION = "0"
PATCH_DISTRO_VERSION = "0"

DISTRO_VERSION = "${MAJOR_DISTRO_VERSION}.${MINOR_DISTRO_VERSION}.${PATCH_DISTRO_VERSION}"
DISTRO_RELEASE = "Stable"

######################
## SDK
######################
TARGET_VENDOR = "-emac"
SDK_VENDOR = "-emacsdk"
SDK_NAME = "${MACHINE}-${DISTRO}-${SDK_ARCH}-toolchain-${DISTRO_VERSION}-${TUNE_PKGARCH}"
SDK_VERSION = "${MAJOR_DISTRO_VERSION}.${MINOR_DISTRO_VERSION}"
SDKPATH  = "/opt/${DISTRO}/${SDK_VERSION}-${MACHINE}"

SDK_DEPLOY ?= "${TMPDIR}/deploy/sdk/${MACHINE}"

######################
## MISC SETTINGS
######################
TOOLCHAIN_OUTPUTNAME ?= "${SDK_NAME}"
BB_SIGNATURE_HANDLER ?= 'OEBasicHash'
FONTCONFIG_CACHE_DIR = "${libdir}/fontconfig/cache"

LICENSE_FLAGS_ACCEPTED:append = " \
    commercial_mpg123 \
    commercial_libav \
    commercial_x264 \
    commercial \
"
ACCEPT_FSL_EULA = "1"

SANITY_TESTED_DISTROS ?= " \
    ubuntu-14.04 \n \
    ubuntu-16.04 \n \
    ubuntu-18.04 \n \
    ubuntu-20.04 \n \
    ubuntu-21.04 \n \
    ubuntu-21.10 \n \
    ubuntu-22.04 \n \
    fedora-24 \n \
    fedora-25 \n \
    centos-7 \n \
    debian-8 \n \
    opensuse-42.1 \n \
    opensuse-42.2 \n \
"

######################
## QA
######################
# QA check settings - a little stricter than the OE-Core defaults
WARN_QA = "textrel files-invalid incompatible-license xorg-driver-abi libdir \
           unknown-configure-option version-going-backwards"
ERROR_QA = "dev-so debug-deps dev-deps debug-files arch pkgconfig la perms \
            useless-rpaths rpaths staticdev ldflags pkgvarcheck already-stripped \
            compile-host-path dep-cmp installed-vs-shipped install-host-path \
            packages-list perm-config perm-line perm-link pkgv-undefined \
            pn-overrides split-strip var-undefined"
            

#######################################
## EXTRA INCLUDE PRE MACHINE BASED
## This is optional but really helps
## when dealing with vendor code (nxp,tegra,ect)
#######################################
include conf/distro/include/machine/${MACHINE}.conf 
```

## meta-emac-distro/conf/distro/emac.conf
```bitbake
######################
## INCLUDES
######################
require conf/distro/poky.conf

######################
## BASIC INFO
######################

DISTRO = "emac"
DISTRO_NAME = "EMAC OpenEmbedded - ${DISTRO_RELEASE}"
DISTRO_CODENAME =  "spike"
MAINTAINER = "EMAC <support@emacinc.com>"

RELEASE_DATE = "Unreleased"

#DISTRO_VERSION = "6.0+snapshot-${METADATA_REVISION}"
DISTRO_VERSION = "6.0.2"
DISTRO_RELEASE = "Unstable"

PACKAGE_FEED_URIS ?= "http://ftp.emacinc.com/openembedded-sw/${DISTRO_CODENAME}-${DISTRO_VERSION}/latest/${MACHINE}"
PACKAGE_FEED_BASE_PATHS ?= "ipk"
PACKAGE_FEED_ARCHS ?= "${ALL_MULTILIB_PACKAGE_ARCHS}"

######################
## SDK
######################
SDK_VENDOR = "-emacsdk"
SDK_NAME = "${DISTRO}-${MACHINE}-${TUNE_PKGARCH}-${TCLIBC}-toolchain-${SDK_ARCH}-${SDK_VERSION}"
SDKPATHINSTALL = "/usr/local/${DISTRO}-${DISTRO_CODENAME}-oe-sdks/${MACHINE}-${TUNE_PKGARCH}-${TCLIBC}-${SDK_VERSION}"

# Choice: systemd, sysvinit, none, mdev-busybox
INIT_MANAGER ?= "systemd"
# Choice: core, busybox
BASE_UTILS ?= "core"

require conf/distro/include/base-utils-${BASE_UTILS}.inc

IMAGE_FEATURES:append = " package-management"
PACKAGE_CLASSES = "package_ipk"
```

## meta-emac-distro/conf/distro/include/base-utils-busybox.inc
```bitbake
PREFERRED_PROVIDER_virtual/base-utils = "busybox"
VIRTUAL-RUNTIME_base-utils = "busybox"
VIRTUAL-RUNTIME_base-utils-hwclock = "busybox-hwclock"
VIRTUAL-RUNTIME_base-utils-syslog = "busybox-syslog"
```

## meta-emac-distro/conf/distro/include/base-utils-core.inc
```bitbake
# Replace busybox
PREFERRED_PROVIDER_virtual/base-utils = "packagegroup-core-base-utils"
VIRTUAL-RUNTIME_base-utils = "packagegroup-core-base-utils"
VIRTUAL-RUNTIME_base-utils-hwclock = "util-linux-hwclock"
VIRTUAL-RUNTIME_base-utils-syslog = ""

SKIP_RECIPE[busybox] ?= "${@bb.utils.contains('INIT_MANAGER', 'systemd', 'Dont build this with systemd', '', d)}"
```

## meta-emac-distro/conf/distro/include/default-emac-providers.inc
```bitbake
# Prefer libjpeg-turbo from meta-oe as it provides SIMD optimizations
PREFERRED_PROVIDER_jpeg ?= "libjpeg-turbo"
PREFERRED_PROVIDER_jpeg-native ?= "libjpeg-turbo-native"

# This line is required until all of the references to libjson are changed in metadata to json-c.
PREFERRED_PROVIDER_libjson = "json-c"


PREFERRED_PROVIDER_virtual/base-utils =   "coreutils"

PREFERRED_PROVIDER_virtual/update-alternatives = "opkg-utils"

PREFERRED_PROVIDER_virtual/update-alternatives-native = "opkg-utils-native"


## run time

PREFERRED_RPROVIDER_libltdl ?= "libtool"
PREFERRED_RPROVIDER_libltdl-native ?= "libtool-native"
```

## meta-emac-distro/conf/layer.conf
```bitbake
# We have a conf and classes directory, add to BBPATH
BBPATH =. "${LAYERDIR}:"

# We have recipes-* directories, add to BBFILES
BBFILES += "${LAYERDIR}/recipes-*/*/*.bb \
            ${LAYERDIR}/recipes-*/*/*.bbappend"

BBFILE_COLLECTIONS += "emac-distro"
BBFILE_PATTERN_emac-distro = "^${LAYERDIR}/"
BBFILE_PRIORITY_emac-distro = "20"


LAYERDEPENDS_emac-distro = " \
    yocto \
    openembedded-layer \
    networking-layer \
    perl-layer \
    meta-python \
"

LAYERSERIES_COMPAT_emac-distro = "kirkstone"
LICENSE_PATH:append = " ${LAYERDIR}/licenses "

BBFILES_DYNAMIC += " \
    qt5-layer:${LAYERDIR}/dynamic-layers/qt5-layer/recipes-*/*/*.bb \
    qt5-layer:${LAYERDIR}/dynamic-layers/qt5-layer/recipes-*/*/*.bbappend \
"
```

## meta-emac-freescale/conf/layer.conf
```bitbake
# We have a conf and classes directory, add to BBPATH
BBPATH =. "${LAYERDIR}:"

# We have recipes-* directories, add to BBFILES
BBFILES += "${LAYERDIR}/recipes-*/*/*.bb \
            ${LAYERDIR}/recipes-*/*/*.bbappend"

BBFILE_COLLECTIONS += "emac-freescale-layer"

BBFILE_PATTERN_emac-freescale-layer = "^${LAYERDIR}/"

BBFILE_PRIORITY_emac-freescale-layer = "7"

LAYERSERIES_COMPAT_emac-freescale-layer = "kirkstone"

LAYERDEPENDS_emac-freescale-layer= " \
    emac-core \
    freescale-layer \
    freescale-3rdparty \
"

BBFILES_DYNAMIC += " \
    qt5-layer:${LAYERDIR}/dynamic-layers/qt5-layer/recipes*/*/*.bb \
"
```

## meta-emac-freescale/conf/machine/include/emac-imx6.inc
```bitbake
PREFERRED_PROVIDER_virtual/kernel ?= "linux-fslc-imx"
PREFERRED_VERSION_linux-fslc-imx ?= "5.15%"

PREFERRED_PROVIDER_virtual/bootloader ?= "u-boot-fslc"

require conf/machine/include/imx-base.inc

# Essential for booting the board
MACHINE_ESSENTIAL_EXTRA_RDEPENDS:append = " \
    kernel-image \
    kernel-devicetree \
    ${@bb.utils.contains('KERNEL_DEVICETREE_BUNDLE','1', 'kernel-image-zimage-bundle','',d)} \
"
KERNEL_DEVICETREE_BUNDLE = "1"
MACHINE_ESSENTIAL_EXTRA_RDEPENDS:append = " ${PREFERRED_PROVIDER_virtual/bootloader}"

MACHINE_FEATURES:append = " arm mtd "

IMX_DEFAULT_BSP = "nxp"

IMX_DEFAULT_KERNEL = "linux-fslc-imx"

KERNEL_IMAGETYPE = "zImage"

IMX_DEFAULT_BOOTLOADER = "u-boot-fslc"
UBOOT_SUFFIX:pn-u-boot-fslc = "img"

SERIAL_CONSOLES = "115200;ttymxc1"
IMAGE_FSTYPES ?= "tar.gz"
```

## meta-emac-freescale/conf/machine/somimx6.conf
```bitbake
#@TYPE: Machine
#@NAME: SoMIMX6
#@DESCRIPTION: Machine configuration for EMAC's SoM-imx6

RESOLUTION = "800x480 1024x600"

MACHINEOVERRIDES =. "mx6:mx6q:"

require conf/machine/include/emac-imx6.inc
require conf/machine/include/arm/armv7a/tune-cortexa9.inc

MACHINE_FEATURES:append = " pci can wifi sound bigflash screen touchscreen "

KERNEL_DEVICETREE ??= " \
	som-imx6q-350es-7.dtb \
	som-imx6q-350es-10.dtb \
"

UBOOT_MACHINE = "somimx6dq_defconfig"

MACHINE_EXTRA_RDEPENDS:append = " \
    linux-firmware-wl18xx \
    libimxdmabuffer \
    kernel-module-imx-gpu-viv \
    imx-gpu-viv \
    imx-codec \
    imx-codec-aac \
    imx-codec-mp3 \
    imx-codec-oggvorbis \
    imx-gpu-g2d \
    libimxvpuapi \
    imx-vpu \
    imx-vpuwrap \
"

SOC_HAS_VIVANTE_KERNEL_DRIVER_SUPPORT = "1"
SOC_HAS_VIVANTE_KERNEL_DRIVER_SUPPORT_imxgpu = "1"
MACHINE_HAS_VIVANTE_KERNEL_DRIVER_SUPPORT = "1"
PREFERRED_PROVIDER_virtual/egl = "imx-gpu-viv"
PREFERRED_PROVIDER_virtual/libgles1 = "imx-gpu-viv"
PREFERRED_PROVIDER_virtual/libgles2 = "imx-gpu-viv"
PREFERRED_PROVIDER_virtual/libgl = "imx-gpu-viv"
PREFERRED_PROVIDER_virtual/libg2d = "imx-gpu-g2d"

PREFERRED_PROVIDER_virtual/egl_imxgpu        = "imx-gpu-viv"
PREFERRED_PROVIDER_virtual/libgl_imxgpu3d    = "imx-gpu-viv"
PREFERRED_PROVIDER_virtual/libgles1_imxgpu3d = "imx-gpu-viv"
PREFERRED_PROVIDER_virtual/libgles2_imxgpu3d = "imx-gpu-viv"
PREFERRED_PROVIDER_virtual/libg2d_imxdpu     = "imx-dpu-g2d"

SERIAL_CONSOLES = "115200;ttymxc1"
MACHINE_SOCARCH = "${DEFAULTTUNE}"  

## INTERNAL

SOM_NUMBER = "11"

BOOTSTRAP_REV = "00.001"
UBOOT_REV = "2022.07"
KERNEL_REV = "5.15-23"
KERNEL_REV = "00.000"

## RR.VVV
FILESYSTEM_REV = "00.000" 
```
