// SPDX-License-Identifier: GPL-2.0-or-later
/*
 * som-a536mp.dts - Device Tree file for the SOM-A536M/P.
 *
 * Copyright (C) 2023 EMAC Inc.
 *
 */

#include "som-a5d36.dts"

/ {
	model = "EMAC SOM-A536M/P";
	compatible = "emac,soma536mp", "atmel,sama5d36", "atmel,sama5d3", "atmel,sama5";
};

&macb0 {
	status = "okay";
	phy-mode = "mii";
	pinctrl-0 = <&pinctrl_macb0_data_mii &pinctrl_macb0_signal_mii>;
};

