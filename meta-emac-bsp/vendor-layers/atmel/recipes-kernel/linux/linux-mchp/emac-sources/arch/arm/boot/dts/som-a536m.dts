// SPDX-License-Identifier: GPL-2.0-or-later
/*
 * som-a536m.dts - Device Tree Overlay file for the SOM-A536M.
 *
 * Copyright (C) 2023 EMAC Inc.
 *
 */

/dts-v1/;
/plugin/;

/ {
	fragment@101 {
		target-path = "/";

		__overlay__ {
			variant = "EMAC SOM-A536M";
			compatible = "emac,soma536m", "emac,soma5d36", "atmel,sama5d36", "atmel,sama5d3", "atmel,sama5";
		};
	};
};

&can1 {
	status = "disabled";
};

&macb0 {
	phy-mode = "mii";
	pinctrl-0 = <&pinctrl_macb0_data_mii &pinctrl_macb0_signal_mii>;
};
