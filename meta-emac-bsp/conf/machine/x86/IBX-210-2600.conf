## meta-emac-bsp/conf/machine/x86/IBX-210-2600.conf
```bitbake
#@TYPE: Machine
#@NAME: IBX-210-2600

#@DESCRIPTION: Machine configuration for IBX-210-2600

include conf/machine/include/emac-x86.inc
include conf/machine/include/tune-atom.inc

RESOLUTION = "1280x1024"
```

## meta-emac-bsp/conf/machine/x86/PCM-9362D.conf
```bitbake
#@TYPE: Machine
#@NAME: atom D510

#@DESCRIPTION: Machine configuration for PCM-9362D with Atom D510.

include conf/machine/include/emac-x86.inc
include conf/machine/include/tune-atom.inc

RESOLUTION = "1600x900"
```

## meta-emac-bsp/conf/machine/x86/PMX-057T.conf
```bitbake
#@TYPE: Machine
#@NAME: PMX-057T

#@DESCRIPTION: Machine configuration for PMX-057T

include conf/machine/include/emac-x86.inc
include conf/machine/include/tune-i586.inc

MACHINE_FEATURES += "touch"
RESOLUTION = "640x480"

GRUB_GFXMODE = "9"
```

## meta-emac-bsp/conf/machine/x86/PMX.conf
```bitbake
#@TYPE: Machine
#@NAME: PMX

#@DESCRIPTION: Machine configuration for PMX panel PCs.

include conf/machine/include/emac-x86.inc
include conf/machine/include/tune-i586.inc

MACHINE_FEATURES += "touch"
RESOLUTION = "640x480 1024x600"

GRUB_GFXMODE = "9"
```

## meta-emac-bsp/conf/machine/x86/VDX-632x-xenomai.conf
```bitbake
#@TYPE: Machine
#@NAME: VDX-632x-xenomai

#@DESCRIPTION: Machine configuration for VDX-632x with xenomai support.

PREFERRED_PROVIDER_virtual/kernel = "linux-xenomai"
PREFERRED_VERSION_linux-xenomai = "3.18-ipipe"

include conf/machine/include/emac-x86.inc
include conf/machine/include/tune-i586.inc

RESOLUTION = "1024x768"

GRUB_GFXMODE = "792"
```

## meta-emac-bsp/conf/machine/x86/VDX-632x.conf
```bitbake
#@TYPE: Machine
#@NAME: VDX-632x

#@DESCRIPTION: Machine configuration for VDX-632x.

include conf/machine/include/emac-x86.inc
include conf/machine/include/tune-i586.inc

RESOLUTION = "800x600"
```

## meta-emac-bsp/conf/machine/x86/VMXP-6427.conf
```bitbake
#@TYPE: Machine
#@NAME: VMXP-6427

#@DESCRIPTION: Machine configuration for VMXP-6427.

include conf/machine/include/emac-x86.inc
include conf/machine/include/tune-i586.inc

RESOLUTION = "1024x768"
```

## meta-emac-bsp/conf/machine/x86/Vortex-SIB.conf
```bitbake
#@TYPE: Machine
#@NAME: Vortex-SIB

#@DESCRIPTION: Machine configuration for Vortex SIB/SBC.

include conf/machine/include/emac-x86.inc
include conf/machine/include/tune-i586.inc

RESOLUTION = "800x600"
```

## meta-emac-bsp/conf/machine/x86/aimb-214.conf
```bitbake
#@TYPE: Machine
#@NAME: AIMB-214

#@DESCRIPTION: Machine configuration for AIMB-214

include conf/machine/include/emac-x86.inc
include conf/machine/include/tune-atom.inc

RESOLUTION = "1024x768"
```

## meta-emac-bsp/conf/machine/x86/atom-sbc-64.conf
```bitbake
#@TYPE: Machine
#@NAME: Atom-SIB

#@DESCRIPTION: Machine configuration for Atom N2600 based SIB/SBCs

include conf/machine/include/emac-x86.inc
include conf/machine/include/tune-atom.inc

MACHINE_EXTRA_RDEPENDS += "grub-efi efibootmgr"

RESOLUTION = "1280x1024"
MACHINE_NUMBER = "002"
KERNEL_REV = "00.000"
FILESYSTEM_REV = "00.000"

DEFAULTTUNE = "core2-64"
```

## meta-emac-bsp/conf/machine/x86/atom-sbc.conf
```bitbake
#@TYPE: Machine
#@NAME: Atom-SIB

#@DESCRIPTION: Machine configuration for Atom N2600 based SIB/SBCs

include conf/machine/include/emac-x86.inc
include conf/machine/include/tune-atom.inc

MACHINE_FEATURES += "touchscreen"
MACHINE_EXTRA_RDEPENDS += "kernel-module-susicores susi-utils"

RESOLUTION = "1600x900 1024x600"
MACHINE_NUMBER = "010"
KERNEL_REV = "00.000"
FILESYSTEM_REV = "00.000"
REV = "1"
```

## meta-emac-bsp/conf/machine/x86/ft10270.conf
```bitbake
#@TYPE: Machine
#@NAME: FT10270

#@DESCRIPTION: Machine configuration for Faytech 10270

include conf/machine/include/emac-x86.inc
include conf/machine/include/tune-atom.inc

MACHINE_FEATURES += "touchscreen"
MACHINE_EXTRA_RDEPENDS += " xf86-video-ati linux-firmware-iwlwifi-4965-2 linux-firmware-radeon "

RESOLUTION = "1024x768"
```

## meta-emac-bsp/conf/machine/x86/ft8270.conf
```bitbake
#@TYPE: Machine
#@NAME: FT8270

#@DESCRIPTION: Machine configuration for Faytech 8270

include conf/machine/include/emac-x86.inc
include conf/machine/include/tune-atom.inc

MACHINE_FEATURES += "touchscreen"
MACHINE_EXTRA_RDEPENDS += " xf86-video-ati linux-firmware-iwlwifi-4965-2 linux-firmware-radeon "

RESOLUTION = "800x600"
```

## meta-emac-bsp/conf/machine/x86/hmi-043t.conf
```bitbake
#@TYPE: Machine
#@NAME: HMI-043T

#@DESCRIPTION: Machine configuration for HMI-043T

include conf/machine/include/emac-x86.inc
include conf/machine/include/tune-i586.inc

MACHINE_FEATURES += " touchscreen can "

RESOLUTION = "480x272"
MACHINE_NUMBER = "000"
REV = "1"

GRUB_GFXMODE = "8"
```

## meta-emac-bsp/conf/machine/x86/pcm-3356.conf
```bitbake
#@TYPE: Machine
#@NAME: PCM-3356

#@DESCRIPTION: Machine configuration for AMD G-Series Processor T16R

include conf/machine/include/emac-x86.inc
include conf/machine/include/tune-core2.inc

SERIAL_CONSOLE = "115200 ttyS2"

MACHINE_EXTRA_RDEPENDS += " xf86-video-ati "

RESOLUTION = "1280x1024"
```

## meta-emac-bsp/conf/machine/x86/pcm-9375.conf
```bitbake
#@TYPE: Machine
#@NAME: PCM-9375

#@DESCRIPTION: Machine configuration for AMD LX800 Processor

include conf/machine/include/emac-x86.inc
include conf/machine/include/tune-i586.inc

RESOLUTION = "640x480 1280x1024"
MACHINE_NUMBER = "S09"
FILESYSTEM_REV = "00.000"
KERNEL_REV = "00.000"
```

## meta-emac-bsp/conf/machine/x86/pcm-9389.conf
```bitbake
#@TYPE: Machine
#@NAME: PCM-9389

#@DESCRIPTION: Machine configuration for PCM-9389 with Atom N455.

include conf/machine/include/emac-x86.inc
include conf/machine/include/tune-atom.inc

RESOLUTION = "1024x768"

MACHINE_EXTRA_RDEPENDS += "kernel-module-susicores susi-utils"
```

## meta-emac-bsp/conf/machine/x86/pmx.conf
```bitbake
#@TYPE: Machine
#@NAME: PMX

#@DESCRIPTION: Machine configuration for PMX panel PCs.

include conf/machine/include/emac-x86.inc
include conf/machine/include/tune-i586.inc

MACHINE_FEATURES += " touchscreen "
RESOLUTION = "640x480 1024x600"
MACHINE_NUMBER = "001"
REV = "1"


GRUB_GFXMODE = "8"
```

## meta-emac-bsp/conf/machine/x86/ppc-150t.conf
```bitbake
#@TYPE: Machine
#@NAME: PPC-150T

#@DESCRIPTION: Machine configuration for PPC-150T.

include conf/machine/include/emac-x86.inc
include conf/machine/include/tune-i586.inc

MACHINE_FEATURES += " touchscreen "
RESOLUTION = "1024x768"
```

## meta-emac-bsp/conf/machine/x86/vdx-632x-xenomai.conf
```bitbake
#@TYPE: Machine
#@NAME: VDX-632x-xenomai

#@DESCRIPTION: Machine configuration for VDX-632x with xenomai support.

PREFERRED_PROVIDER_virtual/kernel = "linux-xenomai"
PREFERRED_VERSION_linux-xenomai = "3.18-ipipe"

MACHINE_EXTRA_RDEPENDS += " xenomai-3 rtdm-gpio-driver "

include conf/machine/include/emac-x86.inc
include conf/machine/include/tune-i586.inc

RESOLUTION = "1024x768"
MACHINE_NUMBER = "001"
REV = "1"

GRUB_GFXMODE = "792"
```

## meta-emac-bsp/conf/machine/x86/vortex-sbc.conf
```bitbake
#@TYPE: Machine
#@NAME: Vortex-SIB

#@DESCRIPTION: Machine configuration for Vortex SIB/SBC.

include conf/machine/include/emac-x86.inc
include conf/machine/include/tune-i586.inc

RESOLUTION = "1024x768"
MACHINE_NUMBER = "003"
REV = "1"

GRUB_GFXMODE = "792"
```

## meta-emac-bsp/recipes-bsp/u-boot/u-boot/emac-sources/board/emacinc/ipac9x25/Kconfig
```kconfig
if TARGET_IPAC9X25

config SYS_BOARD
	default "ipac9x25"

config SYS_VENDOR
	default "emacinc"

config SYS_CONFIG_NAME
	default "ipac9x25"

config DEFAULT_DEVICE_TREE
	default "ipac-9x25"

endif
```

## meta-emac-bsp/recipes-bsp/u-boot/u-boot/emac-sources/board/emacinc/som3354/Kconfig
```kconfig
if TARGET_SOM3354

config SYS_BOARD
	default "som3354"

config SYS_VENDOR
	default "emacinc"

config SYS_SOC
	default "am33xx"

config SYS_CONFIG_NAME
	default "som3354"

endif
```

## meta-emac-bsp/recipes-bsp/u-boot/u-boot/emac-sources/board/emacinc/soma5d35/Kconfig
```kconfig
if TARGET_SOMA5D35

config SYS_BOARD
	default "soma5d35"

config SYS_VENDOR
	default "emacinc"

config SYS_CONFIG_NAME
	default "soma5d35"

config DEFAULT_DEVICE_TREE
	default "som-a5d35"

endif
```

## meta-emac-bsp/recipes-bsp/u-boot/u-boot/emac-sources/configs/emac-som3354_defconfig
```kconfig
CONFIG_ARM=y
CONFIG_ARCH_CPU_INIT=y
CONFIG_ARCH_OMAP2PLUS=y
CONFIG_DEFAULT_DEVICE_TREE="som-3354"
CONFIG_SPL_LIBCOMMON_SUPPORT=y
CONFIG_SPL_LIBGENERIC_SUPPORT=y
CONFIG_ENV_OFFSET=0xC0000
CONFIG_ENV_SECT_SIZE=0x10000
CONFIG_SPL_DM_SPI=y
CONFIG_AM33XX=y
CONFIG_TARGET_SOM3354=y
CONFIG_SPL=y
CONFIG_SPL_LIBDISK_SUPPORT=y
CONFIG_ENV_VARS_UBOOT_CONFIG=y
# CONFIG_FIT is not set
CONFIG_BOOTDELAY=3
CONFIG_USE_BOOTCOMMAND=y
CONFIG_BOOTCOMMAND="led status off;sf probe; sf read ${loadaddr} ${kernelsrcaddr} ${kernelsize};bootz ${loadaddr};"
CONFIG_ARCH_MISC_INIT=y
CONFIG_SPL_ENV_SUPPORT=y
# CONFIG_SPL_NAND_SUPPORT is not set
CONFIG_SPL_DM_SPI_FLASH=y
CONFIG_SPL_POWER=y
CONFIG_SPL_USB_GADGET=y
CONFIG_HUSH_PARSER=y
CONFIG_SYS_PROMPT="U-Boot> "
CONFIG_CMD_BOOTZ=y
CONFIG_CMD_EEPROM=y
CONFIG_SYS_I2C_EEPROM_ADDR_LEN=2
CONFIG_CMD_GPIO=y
CONFIG_CMD_I2C=y
CONFIG_CMD_MMC=y
CONFIG_CMD_USB=y
CONFIG_CMD_DHCP=y
CONFIG_BOOTP_PREFER_SERVERIP=y
CONFIG_CMD_MII=y
CONFIG_CMD_PING=y
CONFIG_CMD_EXT2=y
CONFIG_CMD_EXT4=y
CONFIG_CMD_EXT4_WRITE=y
CONFIG_CMD_FAT=y
CONFIG_OF_CONTROL=y
CONFIG_ENV_IS_IN_SPI_FLASH=y
CONFIG_SYS_RELOC_GD_ENV_ADDR=y
CONFIG_ENV_VARS_UBOOT_RUNTIME_CONFIG=y
CONFIG_VERSION_VARIABLE=y
CONFIG_SPL_DM=y
CONFIG_SPL_DM_SEQ_ALIAS=y
CONFIG_BOOTCOUNT_LIMIT=y
CONFIG_DM_I2C=y
CONFIG_LED=y
CONFIG_LED_GPIO=y
CONFIG_MISC=y
CONFIG_I2C_EEPROM=y
CONFIG_SYS_I2C_EEPROM_ADDR=50
CONFIG_SUPPORT_EMMC_BOOT=y
CONFIG_MMC_OMAP_HS=y
CONFIG_DM_SPI_FLASH=y
CONFIG_SF_DEFAULT_SPEED=40000000
CONFIG_SPI_FLASH_STMICRO=y
# CONFIG_SPI_FLASH_USE_4K_SECTORS is not set
CONFIG_PHY_ADDR_ENABLE=y
CONFIG_PHY_MICREL=y
CONFIG_DM_ETH=y
CONFIG_DM_MDIO=y
CONFIG_MII=y
CONFIG_DRIVER_TI_CPSW=y
CONFIG_DM_PMIC=y
CONFIG_DM_PMIC_TPS65910=y
CONFIG_DM_REGULATOR=y
CONFIG_DM_REGULATOR_FIXED=y
CONFIG_DM_REGULATOR_GPIO=y
CONFIG_SPI=y
CONFIG_DM_SPI=y
CONFIG_OMAP3_SPI=y
CONFIG_TIMER=y
CONFIG_OMAP_TIMER=y
CONFIG_USB=y
CONFIG_DM_USB_GADGET=y
CONFIG_SPL_DM_USB_GADGET=y
CONFIG_USB_MUSB_HOST=y
CONFIG_USB_MUSB_GADGET=y
CONFIG_USB_MUSB_TI=y
CONFIG_USB_STORAGE=y
CONFIG_USB_GADGET=y
CONFIG_USB_GADGET_MANUFACTURER="Texas Instruments"
CONFIG_USB_GADGET_VENDOR_NUM=0x0451
CONFIG_USB_GADGET_PRODUCT_NUM=0xd022
CONFIG_USB_GADGET_DOWNLOAD=y
CONFIG_USB_ETHER=y
CONFIG_WATCHDOG_TIMEOUT_MSECS=120000
CONFIG_WDT=y
# CONFIG_SPL_USE_TINY_PRINTF is not set
# CONFIG_OF_LIBFDT_OVERLAY is not set
# CONFIG_EFI_LOADER is not set
```
