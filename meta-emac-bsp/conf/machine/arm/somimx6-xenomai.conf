## meta-emac-bsp/conf/machine/arm/somimx6-xenomai.conf
```bitbake
#@TYPE: Machine
#@NAME: SoMIMX6-Xenomai

#@DESCRIPTION: Machine configuration for EMAC's SoM-imx6 with Xenomai

include conf/machine/arm/somimx6.conf

PREFERRED_PROVIDER_virtual/kernel = "linux-xenomai"
PREFERRED_VERSION_linux-xenomai = "4.9.95-ipipe%"

SOC_FAMILY = "mx6:mx6q:mx6dl:"
MACHINEOVERRIDES =. "mx6:mx6q:mx6dl:"
DEFAULTTUNE = "cortexa9thf-neon"
```

## meta-emac-bsp/conf/machine/arm/somimx6.conf
```bitbake
#@TYPE: Machine
#@NAME: SoMIMX6

#@DESCRIPTION: Machine configuration for EMAC's SoM-imx6

RESOLUTION = "800x480 1024x600"

MACHINE_FEATURES += "bigflash screen touchscreen"

MACHINE_EXTRA_RDEPENDS += "linux-firmware-wl18xx"

include conf/machine/include/emac-imx6.inc
include conf/machine/include/tune-cortexa9.inc

KERNEL_DEVICETREE = " \
	som-imx6q-350es.dtb \
	som-imx6q-350es-10.dtb \
"

SOM_NUMBER = "11"
BOOTSTRAP_REV = "00.000"
UBOOT_REV = "00.000"
KERNEL_REV = "00.000"
FILESYSTEM_REV = "00.000"
```

## meta-emac-bsp/conf/machine/arm/somimx6q-ha.conf
```bitbake
#@TYPE: Machine
#@NAME: SoMIMX6
#@DESCRIPTION: Machine configuration for EMAC's SoM-imx6q with hardware acceleration

SOC_FAMILY = "mx6:mx6q:mx6dl:"
MACHINEOVERRIDES =. "mx6:mx6q:mx6dl:"
MACHINEOVERRIDES_EXTENDER  = "imxfbdev:imxipu:imxvpu:imxgpu:imxgpu2d:imxgpu3d"

RESOLUTION = "800x480 1024x600"

MACHINE_EXTRA_RDEPENDS += " \
    linux-firmware-wl18xx \
    libimxdmabuffer \
    kernel-module-imx-gpu-viv \
    imx-gpu-viv \
    imx-gpu-viv-demos \
    imx-gpu-viv-tools \
    gstreamer1.0-plugins-imx \
    imx-codec \
    imx-codec-aac \
    imx-codec-mp3 \
    imx-codec-oggvorbis \
    imx-gpu-g2d \
    libimxvpuapi \
    imx-vpu \
    imx-vpuwrap \
"

require conf/machine/include/imx-base.inc
require conf/machine/include/tune-cortexa9.inc

MACHINE_FEATURES += " usbgadget usbhost arm pci can wifi sound bigflash screen touchscreen"

############################## 
PREFERRED_PROVIDER_virtual/kernel ?= "linux-fslc-imx"
PREFERRED_PROVIDER_virtual/bootloader = "u-boot-emac"

PREFERRED_PROVIDER_virtual/egl ?= "imx-gpu-viv"
PREFERRED_PROVIDER_virtual/libgles1 ?= "imx-gpu-viv"
PREFERRED_PROVIDER_virtual/libgles2 ?= "imx-gpu-viv"
PREFERRED_PROVIDER_virtual/libgl ?= "imx-gpu-viv"
PREFERRED_PROVIDER_virtual/libg2d ?= "imx-gpu-g2d"

PREFERRED_PROVIDER_virtual/egl_imxgpu        ?= "imx-gpu-viv"
PREFERRED_PROVIDER_virtual/libgl_imxgpu3d    ?= "imx-gpu-viv"
PREFERRED_PROVIDER_virtual/libgles1_imxgpu3d ?= "imx-gpu-viv"
PREFERRED_PROVIDER_virtual/libgles2_imxgpu3d ?= "imx-gpu-viv"
PREFERRED_PROVIDER_virtual/libg2d_imxdpu     ?= "imx-dpu-g2d"

MACHINE_GSTREAMER_1_0_PLUGIN = "imx-gst1.0-plugin"
PREFERRED_VERSION_gstreamer1.0 = "1.16.imx"
PREFERRED_VERSION_gstreamer1.0-plugins-base = "1.16.imx"
PREFERRED_VERSION_gstreamer1.0-plugins-good = "1.16.imx"
PREFERRED_VERSION_gstreamer1.0-plugins-bad = "1.16.imx"
PREFERRED_VERSION_gstreamer1.0-plugins-ugly = "1.16.0"
PREFERRED_VERSION_gstreamer1.0-libav = "1.16.0"
################################################

SERIAL_CONSOLE = "115200 ttymxc1"
SERIAL_CONSOLES = "115200;ttymxc1"

## must have _${MACHINE} (_somimx6q-ha) or imxbase will make into a hardfloat
## ..later
## and there is a good reason for this.  It is because of all imx pre-built libs(vivante statck userland)
## was compiled as a hardfloat and not soft  ..... 

#DEFAULTTUNE_somimx6q-ha = "armv7a-neon"
MACHINE_SOCARCH = "${DEFAULTTUNE}"  

IMX_DEFAULT_BOOTLOADER="u-boot-emac"
UBOOT_SUFFIX = "img"
UBOOT_MACHINE = "somimx6dq_defconfig"
UBOOT_MAKE_TARGET = "all"
SPL_BINARY = "SPL"


IMX_DEFAULT_KERNEL = "linux-fslc-imx"
KERNEL_IMAGETYPE ?= "zImage"
KERNEL_DEVICETREE = " \
	som-imx6q-350es.dtb \
	som-imx6q-350es-10.dtb \
"

KERNEL_MODULE_AUTOLOAD += " \
    mxc_v4l2_capture \
"

SOC_HAS_VIVANTE_KERNEL_DRIVER_SUPPORT = "1"
SOC_HAS_VIVANTE_KERNEL_DRIVER_SUPPORT_imxgpu = "1"
MACHINE_HAS_VIVANTE_KERNEL_DRIVER_SUPPORT = "1"
IMX_DEFAULT_BSP = "nxp"

SOM_NUMBER = "11"
BOOTSTRAP_REV = "00.001"
UBOOT_REV = "00.001"
KERNEL_REV = "00.000"
FILESYSTEM_REV = "00.000"

IMAGE_FSTYPES = "tar.gz"
```

## meta-emac-bsp/conf/machine/arm/somimx6ul.conf
```bitbake
#@TYPE: Machine
#@NAME: SoMIMX6UL

#@DESCRIPTION: Machine configuration for EMAC's SoM-imx6ul

MACHINE_FEATURES += "bigflash can"

include conf/machine/include/emac-imx6.inc
include conf/machine/include/tune-cortexa7.inc

SERIAL_CONSOLE = "115200 ttymxc4"
USE_VT = "0"
MACHINE_EXTRA_RDEPENDS += "linux-firmware-bcm43430"

KERNEL_DEVICETREE = " \
	som-imx6ul-150es.dtb \
	som-imx6ul-112es.dtb \
"
UBOOT_MACHINE = "somimx6ul_defconfig"

SOM_NUMBER = "10"
BOOTSTRAP_REV = "00.000"
UBOOT_REV = "00.000"
KERNEL_REV = "00.000"
FILESYSTEM_REV = "00.000"
```

## meta-emac-bsp/conf/machine/carriers/som-200.conf
```bitbake
RESOLUTION = "480x272"
MACHINE_FEATURES_append = " screen touch sound "
CARRIER_NUMBER = "2"
```

## meta-emac-bsp/conf/machine/carriers/som-210.conf
```bitbake
RESOLUTION = "480x272"
MACHINE_FEATURES_append = " screen touch "
CARRIER_NUMBER = "3"
```

## meta-emac-bsp/conf/machine/carriers/som-212.conf
```bitbake
RESOLUTION = "480x272"
MACHINE_FEATURES += " screen touch sound "
CARRIER_NUMBER = "4"
```

## meta-emac-bsp/conf/machine/carriers/som-250-10.conf
```bitbake
RESOLUTION = "1024x600"
MACHINE_FEATURES += " screen touch sound "
CARRIER_NUMBER = "5"
```

## meta-emac-bsp/conf/machine/carriers/som-250-7.conf
```bitbake
RESOLUTION = "800x480"
MACHINE_FEATURES += " screen touch sound "
CARRIER_NUMBER = "5"
```

## meta-emac-bsp/conf/machine/genericx86-i586.conf
```bitbake
#@TYPE: Machine
#@NAME: Generic x86 (i586 tune)
#@DESCRIPTION: Machine configuration for generic x86 (32-bit) PCs. Supports a moderately wide range of drivers that should boot and be usable on "typical" hardware.

DEFAULTTUNE ?= "i586"
require conf/machine/include/x86/tune-i586.inc
require conf/machine/include/genericx86-common.inc

MACHINE_ESSENTIAL_EXTRA_RRECOMMENDS:append = " gma500-gfx-check"
#For runqemu
QB_SYSTEM_NAME = "qemu-system-i386"
```

## meta-emac-bsp/conf/machine/ipac9x25.conf
```bitbake
#@TYPE: Machine
#@NAME: ipac9x25
#@DESCRIPTION: Machine configuration for ipac9x25.

include conf/machine/include/at91sam9x5.inc

MACHINE_FEATURES = "apm alsa can ext2 rtc serial usbhost usbgadget vfat i2c spi gpio"
KERNEL_DEVICETREE = "ipac9x25.dtb"

IMAGE_FSTYPES:append = " tar.gz wic.gz"

WKS_FILE = "sdimage-bootpart.wks"
IMAGE_BOOT_FILES = "zImage ${KERNEL_DEVICETREE}"

UBOOT_MACHINE ?= "ipac9x25_mmc_defconfig"
UBOOT_ENTRYPOINT = "0x20008000"
UBOOT_LOADADDRESS = "0x20008000"
UBOOT_ENV_SIZE = "0x4000"
PREFERRED_VERSION_at91bootstrap = "3.10.2"

AT91BOOTSTRAP_MACHINE ?= "ipac9x25"

# Needed for FIT
#MACHINE_ESSENTIAL_EXTRA_RDEPENDS = " dt-overlay-mchp"

SERIAL_CONSOLES = "115200;ttyS5"

# Has an 8MB Serial Flash
# 0x0 - 0x7F_FFFF

EXTRA_IMAGEDEPENDS:append = " sam-ba-util-native"
```

## meta-emac-bsp/conf/machine/pcm-9375.conf
```bitbake
require conf/machine/genericx86-i586.conf
MACHINEOVERRIDES:append = ":genericx86-i586"
MACHINE_ESSENTIAL_EXTRA_RRECOMMENDS:remove = "gma500-gfx-check"
```

## meta-emac-bsp/conf/machine/sdk/586.conf
```bitbake
#@TYPE: Machine
#@NAME: PMX-090T

#@DESCRIPTION: Machine configuration for generic i586 machines.  Used for building the SDK against.

include conf/machine/include/emac-x86.inc
include conf/machine/include/tune-i586.inc

MACHINE_FEATURES += "touch"
```

## meta-emac-bsp/conf/machine/sdk/emac-arm.conf
```bitbake
#@TYPE: Machine
#@NAME: armv5

#@DESCRIPTION: Machine configuration for generic armv5 machines.  Used for building the SDK against.

include conf/machine/include/tune-arm926ejs.inc

PREFERRED_PROVIDER_virtual/kernel = "linux-dummy"
IMAGE_FSTYPES = "tar.gz"
DEBUG_BUILD = "1"
```

## meta-emac-bsp/conf/machine/sdk/emac-x86-64.conf
```bitbake
#@TYPE: Machine
#@NAME: x86-64

#@DESCRIPTION: Machine configuration for generic i586 machines.  Used for building the SDK against.

include conf/machine/include/tune-core2.inc

DEFAULTTUNE = "core2-64"

PREFERRED_PROVIDER_virtual/kernel = "linux-dummy"
IMAGE_FSTYPES = "tar.gz"
DEBUG_BUILD = "1"
```

## meta-emac-bsp/conf/machine/sdk/emac-x86.conf
```bitbake
#@TYPE: Machine
#@NAME: x86

#@DESCRIPTION: Machine configuration for generic i586 machines.  Used for building the SDK against.

include conf/machine/include/tune-i586.inc

PREFERRED_PROVIDER_virtual/kernel = "linux-dummy"
IMAGE_FSTYPES = "tar.gz"
DEBUG_BUILD = "1"
```

## meta-emac-bsp/conf/machine/som-5728m.conf
```bitbake
#@TYPE: Machine
#@NAME: SoM-5728M
#@DESCRIPTION: Machine configuration for the SoM-5728M

MACHINEOVERRIDES =. "dra7xx-evm:"
include conf/machine/dra7xx-evm.conf

KERNEL_DEVICETREE_PREFIX = " emac-som-5728m"
KERNEL_DEVICETREE = "emac-som-5728m-350es.dtb"

UBOOT_MACHINE = "emac-som-5728m_config"

MACHINE_FEATURES:append = " serial ext3 ext4 can i2c spi wifi bluetooth"

PREFERRED_PROVIDER_virtual/gpudriver = "ti-sgx-ddk-km"

# Taken from meta-arago
# Prefer OpenSSL over GnuTLS for curl due to TSU exemptions
PACKAGECONFIG:pn-curl = "${@bb.utils.contains("DISTRO_FEATURES", "ipv6", "ipv6", "", d)} proxy openssl verbose zlib"
PACKAGECONFIG:pn-glmark2 = "drm-gles2 wayland-gles2"
# Enable encryption support in open62541
PACKAGECONFIG:append:pn-open62541 = " encrypt"
# Enable netperf intervals/pacing and histogram
PACKAGECONFIG:append:pn-netperf = " intervals histogram"
# Use OpenGL ES2 for SDL2
PACKAGECONFIG_GL:pn-libsdl2 = "gles2"
# Add KMS/DRM backend support
PACKAGECONFIG:append:pn-libsdl2 = " kmsdrm"
# Enable cryptodev/devcrypto engine in OpenSSL 1.1
PACKAGECONFIG:append:pn-openssl = " cryptodev-linux"
# Enable GST_TRACER logging in gstreamer
PACKAGECONFIG:append:pn-gstreamer1.0 = " tracer-hooks"
# Enable EGL/GLESv2 support on non-x11
PACKAGECONFIG:append:pn-cairo = " egl ${@bb.utils.contains("DISTRO_FEATURES", "x11", "", "glesv2", d)}"

IMAGE_INSTALL:append = " \
    i2c-tools \
    spidev-test \
    kernel-modules \
    alsa-utils-aplay \
    ethtool \
    packagegroup-ti-connectivity \
"

PREFERRED_PROVIDER_wpa-supplicant:omap-a15 = "wpa-supplicant-wl18xx"
```

## meta-emac-bsp/conf/machine/som5728.conf
```bitbake
#@TYPE: Machine
#@NAME: SOM-5728
#@DESCRIPTION: Machine configuration for the SOM-5728

MACHINEOVERRIDES =. "dra7xx-evm:"
include conf/machine/dra7xx-evm.conf

KERNEL_DEVICETREE = ""

UBOOT_MACHINE = "dra7xx_evm_config"

MACHINE_FEATURES:append = " serial ext3 ext4 can i2c spi"

PREFERRED_PROVIDER_virtual/gpudriver = "ti-sgx-ddk-km"

# Taken from meta-arago
# Prefer OpenSSL over GnuTLS for curl due to TSU exemptions
PACKAGECONFIG:pn-curl = "${@bb.utils.contains("DISTRO_FEATURES", "ipv6", "ipv6", "", d)} proxy openssl verbose zlib"
PACKAGECONFIG:pn-glmark2 = "drm-gles2 wayland-gles2"
# Enable encryption support in open62541
PACKAGECONFIG:append:pn-open62541 = " encrypt"
# Enable netperf intervals/pacing and histogram
PACKAGECONFIG:append:pn-netperf = " intervals histogram"
# Use OpenGL ES2 for SDL2
PACKAGECONFIG_GL:pn-libsdl2 = "gles2"
# Add KMS/DRM backend support
PACKAGECONFIG:append:pn-libsdl2 = " kmsdrm"
# Enable cryptodev/devcrypto engine in OpenSSL 1.1
PACKAGECONFIG:append:pn-openssl = " cryptodev-linux"
# Enable GST_TRACER logging in gstreamer
PACKAGECONFIG:append:pn-gstreamer1.0 = " tracer-hooks"
# Enable EGL/GLESv2 support on non-x11
PACKAGECONFIG:append:pn-cairo = " egl ${@bb.utils.contains("DISTRO_FEATURES", "x11", "", "glesv2", d)}"
```

## meta-emac-bsp/conf/machine/soma536mp.conf
```bitbake
#@TYPE: Machine
#@Name: ATMEL SAMA5D3 Xplained SD
#@DESCRIPTION: Machine configuration for Atmel's evaluation board


MACHINEOVERRIDES =. "soma5d36:"
include conf/machine/soma5d36.conf
```

## meta-emac-bsp/conf/machine/soma5d36.conf
```bitbake
#@TYPE: Machine
#@Name: ATMEL SAMA5D3 Xplained SD
#@DESCRIPTION: Machine configuration for Atmel's evaluation board

include conf/machine/include/sama5d3.inc

MACHINE_FEATURES = "apm alsa can ext2 rtc serial usbhost usbgadget vfat screen touchscreen wifi i2c spi gpio sound"
KERNEL_DEVICETREE = "\
    som-a5d36-2xx.dtb \
    som-a5d36-200gs.dtb \
    som-a5d36-212es.dtb \
    som-a5d36-250gs.dtb \
    som-a536m.dtbo \
    som-a536p.dtbo \
"
IMAGE_FSTYPES += " tar.gz wic.gz"

WKS_FILE = "sdimage-bootpart.wks"
IMAGE_BOOT_FILES = "zImage ${KERNEL_DEVICETREE}"

# used by sysvinit_2
SERIAL_CONSOLES ?= "115200;ttyS0 115200;ttyGS0"

SPL_BINARY = ""
UBOOT_ENTRYPOINT = "0x20008000"
UBOOT_LOADADDRESS = "0x20008000"
UBOOT_ENV_SIZE = "0x4000"

# Has an 16MB Serial Flash
# 0x0 - 0xFF_FFFF
EXTRA_IMAGEDEPENDS:append = " sam-ba-util-native"

MACHINE_EXTRA_RDEPENDS:append = " kernel-modules kernel-devicetree"

# Performance is bad with systemd on this machine, use sysvinit
INIT_MANAGER ?= "sysvinit"
```

## meta-emac-bsp/conf/machine/somimx6.conf
```bitbake
#@TYPE: Machine
#@NAME: SoMIMX6
#@DESCRIPTION: Machine configuration for EMAC's SoM-imx6

MACHINEOVERRIDES =. "mx6q:mx6dl:"

include conf/machine/include/imx-base.inc
include conf/machine/include/arm/armv7a/tune-cortexa9.inc

IMX_DEFAULT_BSP = "nxp"
IMX_DEFAULT_BOOTLOADER = "u-boot-emac"

SERIAL_CONSOLES = "115200;ttymxc1"

KERNEL_DEVICETREE = " \
	emac-som-imx6m-350es.dtb \
"

SPL_BINARY = "SPL"
UBOOT_SUFFIX = "img"
UBOOT_MAKE_TARGET = ""

UBOOT_CONFIG ??= "emac"
UBOOT_CONFIG[emac] = "somimx6dq_defconfig"

MACHINE_FEATURES:append = " arm mtd pci can i2c spi gpio wifi sound screen touchscreen "
MACHINE_EXTRA_RRECOMMENDS += "${MACHINE_FIRMWARE}"
MACHINE_FIRMWARE:append = " \
    linux-firmware-bcm43430 \
    linux-firmware-ti-bt \
    linux-firmware-wl12xx \
    linux-firmware-wl18xx \
    ti-18xx-wlconf \
"
MACHINE_ESSENTIAL_EXTRA_RDEPENDS += " \
    kernel-image \
    kernel-devicetree \
    ${IMX_DEFAULT_BOOTLOADER} \
"

WKS_FILES ?= "imx-uboot-spl-bootpart.wks.in"
WKS_FILE_DEPENDS ?= ""
IMAGE_FSTYPES = "wic.xz wic.bmap tar.gz"

PACKAGECONFIG_X11:pn-gstreamer1.0-plugins-base = ""

EXTRA_IMAGEDEPENDS:append = " imx-usb-loader-native"
```

## meta-emac-bsp/conf/machine/somimx6ul.conf
```bitbake
#@TYPE: Machine
#@NAME: SoMIMX6UL
#@DESCRIPTION: Machine configuration for EMAC's SoM-imx6ul

MACHINEOVERRIDES =. "mx6ul:"

include conf/machine/include/imx-base.inc
include conf/machine/include/arm/armv7a/tune-cortexa7.inc

IMX_DEFAULT_BSP = "nxp"
IMX_DEFAULT_BOOTLOADER = "u-boot-emac"

SERIAL_CONSOLES = "115200;ttymxc4"

KERNEL_DEVICETREE = " \
	emac-som-imx6ul-112es.dtb \
	emac-som-imx6ul-150es.dtb \
"

SPL_BINARY = "SPL"
UBOOT_SUFFIX = "img"
UBOOT_MAKE_TARGET = ""

UBOOT_MACHINE = "somimx6ul_defconfig"

MACHINE_FEATURES:remove = "touchscreen screen"
MACHINE_FEATURES:append = " apm arm mtd wifi bluetooth sound can i2c spi gpio serial"
MACHINE_EXTRA_RDEPENDS:append = " linux-firmware-bcm43430 "
MACHINE_ESSENTIAL_EXTRA_RDEPENDS += " \
    kernel-image \
    kernel-devicetree \
    ${IMX_DEFAULT_BOOTLOADER} \
"

WKS_FILES ?= "imx-uboot-spl-bootpart.wks.in"
WKS_FILE_DEPENDS ?= ""
IMAGE_FSTYPES = "wic.xz ext4.gz tar.gz"
```

## meta-emac-bsp/conf/machine/x86/Atom-SIB.conf
```bitbake
#@TYPE: Machine
#@NAME: Atom-SIB

#@DESCRIPTION: Machine configuration for Atom N2600 based SIB/SBCs

include conf/machine/include/emac-x86.inc
include conf/machine/include/tune-atom.inc

MACHINE_EXTRA_RDEPENDS += "kernel-module-susicores susi-utils"

RESOLUTION = "1600x900"
MACHINE_NUMBER = "010"
REV = "1"
```

## meta-emac-bsp/conf/machine/x86/GENE-LN05.conf
```bitbake
#@TYPE: Machine
#@NAME: GENE-LN05

#@DESCRIPTION: Machine configuration for GENE-LN05 with Atom N455.

include conf/machine/include/emac-x86.inc
include conf/machine/include/tune-atom.inc

RESOLUTION = "1024x768"
```
