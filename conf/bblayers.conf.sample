## conf/bblayers.conf.sample
```bitbake
# LAYER_CONF_VERSION is increased each time build/conf/bblayers.conf
# changes incompatibly
LCONF_VERSION = "7"

BBPATH = "${TOPDIR}"
BBFILES ?= ""

CORE_RECIPES = " \
    ##OEROOT##/emac-oe/meta-emac \
    \
    ##OEROOT##/poky/meta \
    ##OEROOT##/meta-openembedded/meta-oe \
    ##OEROOT##/meta-openembedded/meta-networking \
    ##OEROOT##/meta-openembedded/meta-multimedia \
    ##OEROOT##/meta-openembedded/meta-python \
    ##OEROOT##/meta-openembedded/meta-filesystems \
    ##OEROOT##/meta-openembedded/meta-perl \
"
# BSP BASED

INTEL_RECIPES = " \
    ##OEROOT##/meta-intel \
    ##OEROOT##/emac-oe/meta-emac-intel \
"

ATMEL_RECIPES = " \
    ##OEROOT##/emac-oe/meta-emac-atmel \
    ##OEROOT##/meta-atmel \
"

NXP_RECIPES = " \
    ##OEROOT##/emac-oe/meta-emac-freescale \
    ##OEROOT##/meta-freescale \
    ##OEROOT##/meta-freescale-3rdparty \
"

# READ you need to add this here if you are using nvidia(tegra)
# TD_BBLAYERS_CONF_VERSION = "emactegra-3"
TEGRA_RECIPES = " \
    ##OEROOT##/emac-oe/meta-emac-tegra \
    ##OEROOT##/meta-tegra \
    ##OEROOT##/meta-tegra/contrib  \
    ##OEROOT##/meta-virtualization \
"

TI_RECIPES = " \
    ##OEROOT##/emac-oe/meta-emac-ti/meta-emac-ti-bsp \
    ##OEROOT##/emac-oe/meta-emac-ti/meta-emac-ti-extras \
    ##OEROOT##/emac-oe/meta-emac-ti/meta-emac-arago-distro \
    ##OEROOT##/emac-oe/meta-emac-ti/meta-emac-arago-extras \
    ##OEROOT##/meta-ti/meta-ti-bsp \
    ##OEROOT##/meta-ti/meta-ti-extras \
    ##OEROOT##/meta-arm/meta-arm \
    ##OEROOT##/meta-arm/meta-arm-toolchain \
"
 
QT5_RECIPES = " \
    ##OEROOT##/emac-oe/meta-emac-qt5 \
    ##OEROOT##/meta-qt5  \   
    ##OEROOT##/meta-python2 \
"

CHROME_RECIPES += " \
    ##OEROOT##/meta-browser/meta-chromium \
    ##OEROOT##/meta-clang \
    ##OEROOT##/emac-oe/meta-emac-web/meta-chromium \
"

WEBSERVER_RECIPES += " \
    ##OEROOT##/emac-oe/meta-emac-web/meta-webserver \
"

XENOMAI_RECIPES += " \
    ##OEROOT##/emac-oe/meta-emac-xenomai \
"

STM_RECIPES += " \
    ##OEROOT##/meta-st-stm32mp-addons \
    ##OEROOT##/meta-st-stm32mpu-app-logicanalyser \
    ##OEROOT##/meta-st-stm32mp-oss \
    ##OEROOT##/meta-st-stm32mpu-ai \
    ##OEROOT##/meta-st-stm32mp \
"


#Change this to fit your needs
BBLAYERS ?= " \
  ${CORE_RECIPES} \
"
```

## conf/local.conf.sample
```bitbake
DISTRO_CODENAME ?= "spike"
DL_DIR = "/srv/emac-oe/downloads"
STAMPS_DIR = "/srv/emac-oe/${DISTRO_CODENAME}/stamps"
SSTATE_DIR = "/srv/emac-oe/${DISTRO_CODENAME}/sstate-cache/"
DISTRO ?= "emac"
# DISTRO = "emactegra"
# DISTRO = "emactiny"

PACKAGE_CLASSES ?= "package_rpm package_ipk package_deb"

SDKMACHINE ?= "x86_64"

USER_CLASSES ?= "buildstats"

OE_TERMINAL = "auto"

PATCHRESOLVE = "noop"

BB_DISKMON_DIRS ??= "\
    STOPTASKS,${TMPDIR},1G,100K \
    STOPTASKS,${DL_DIR},1G,100K \
    STOPTASKS,${SSTATE_DIR},1G,100K \
    STOPTASKS,/tmp,100M,100K \
    HALT,${TMPDIR},100M,1K \
    HALT,${DL_DIR},100M,1K \
    HALT,${SSTATE_DIR},100M,1K \
    HALT,/tmp,10M,1K"


CONF_VERSION = "2"
INHERIT:append  = " buildhistory image-buildinfo rm_work"
BUILDHISTORY_COMMIT = "1"
BB_NUMBER_THREADS ?= "20"
PARALLEL_MAKE ?= "-j 12"

BBMULTICONFIG = " \
    qemu-x86-64 \
    qemu-armv7 \
"

######################
## EMAC arm boards
#######################
## EMAC's NXP
# MACHINE ?= "somimx6-ha"
MACHINE ??= "somimx6"
# MACHINE ?= "somimx6-rt"
# MACHINE ?= "somimx6ul"

## EMAC's TI
# MACHINE ?= "som3517"
# MACHINE ?= "som3354"

## EMAC's Microchip
# MACHINE ?= "soma5d36"
# MACHINE ?= "soma5d35"
# MACHINE ?= "som9x25"
# MACHINE ?= "som9g45"
# MACHINE ?= "som9g25"
# MACHINE ?= "som9g20"
# MACHINE ?= "ipac9x25"

## EMAC x86 boards
# MACHINE ?= "vdx-632x-xenomai"
# MACHINE ?= "vortex-sbc"
# MACHINE ?= "vox-150"
# MACHINE ?= "pmx"
# MACHINE ?= "pcm-9375"
# MACHINE ?= "pcm-3356"
# MACHINE ?= "ppc-150t"
# MACHINE ?= "hmi-043t"
# MACHINE ?= "ppc-150t"
# MACHINE ?= "ft10270"
# MACHINE ?= "ft8270"
# MACHINE ?= "atom-sbc-ia64"
# MACHINE ?= "atom-sbc-64"
# MACHINE ?= "atom-sbc-64-x32"
# MACHINE ?= "atom-sbc-32"
# MACHINE ?= "aimb-214"

######################
## EMAC SETTINGS
#######################
## none, opengl, vulkan
EMAC_DISPLAY_HW ?= "none"
## none, linuxfb, wayland, x11
EMAC_DISPLAY ?= "none"
## coreutils, busybox
EMAC_SHELLMANAGER ?= "coreutils"
## systemd, sysvinit
EMAC_INITMANAGER ?= "systemd"
## connman, networkmanager, legacy
EMAC_NETWORKMANGER ?= "networkmanager"
## alsa, pulseaudio
EMAC_AUDIOMANAGER ?= "alsa"
## deb, rpm, ipk
EMAC_PACKAGEMANAGER ?= "rpm"

###########################################
## INTERNAL DO NOT CHANGE
###########################################
EMAC_CLIENT_NAME ?= "emac"
EMAC_IMAGE ?= "emac-image"

DEPLOY_DIR        = "/srv/emac-oe/${DISTRO_CODENAME}/deploy/${EMAC_CLIENT_NAME}/${EMAC_IMAGE}/${MACHINE}"
DEPLOY_DIR_IMAGE  = "${DEPLOY_DIR}/image"

## SSTATE_DUPWHITELIST is set to this, if needing to change license dirs add it to this var
LICENSE_DIRECTORY = "${DEPLOY_DIR}/licenses" 

DEPLOY_DIR_DEB    = "${DEPLOY_DIR}/deb"
DEPLOY_DIR_IPK    = "${DEPLOY_DIR}/ipk"
DEPLOY_DIR_RPM    = "${DEPLOY_DIR}/rpm"

# TEST_TARGET = "emac-image"
# TEST_TARGET_IP = "<10.0.X.XXX>"
# TEST_SERVER_IP = "<10.0.X.XXX>"

## needs MACHINE, EMAC_CLIENT_NAME, and EMAC_IMAGE exported to env before run (AUTO BUILDER ONLY)
```

## meta-emac-atmel/conf/layer.conf
```bitbake
# We have a conf and classes directory, add to BBPATH
BBPATH =. "${LAYERDIR}:"

# We have recipes-* directories, add to BBFILES
BBFILES += "${LAYERDIR}/recipes-*/*/*.bb \
            ${LAYERDIR}/recipes-*/*/*.bbappend"

BBFILE_COLLECTIONS += "emac-atmel-layer"

BBFILE_PATTERN_emac-atmel-layer = "^${LAYERDIR}/"

BBFILE_PRIORITY_emac-atmel-layer = "11"

LAYERSERIES_COMPAT_emac-atmel-layer = "kirkstone"

# atmel depends on meta-arm and meta-arm-toolchain
# they really should make it a dynamic layer or add it to the depends
LAYERDEPENDS_emac-atmel-layer= " \
    emac-bsp \
    atmel \
    meta-arm \
    arm-toolchain \
"
```

## meta-emac-atmel/conf/machine/include/emac-9g.inc
```bitbake
## BOOTLOADER
AT91BOOTSTRAP_MACHINE ?= "som9x25"
UBOOT_MACHINE ?= "som9x25_config"
UBOOT_ENTRYPOINT ?= "0x70008000"
KERNEL_IMAGETYPE ?= "zImage"

require conf/machine/include/at91sam9.inc

MACHINE_FEATURES:prepend = " arm "

PREFERRED_PROVIDER_virtual/bootloader:sama5 = "u-boot-emac-at91"
PREFERRED_PROVIDER_virtual/bootloader = "u-boot-emac-at91"

PREFERRED_PROVIDER_u-boot:sama5 = "u-boot-emac-at91"

PREFERRED_PROVIDER_at91bootstrap = "at91bootstrap-emac"
PREFERRED_VERSION_at91bootstrap = "3.9.3%"

## KERNEL
PREFERRED_PROVIDER_virtual/kernel = "linux-emac"
PREFERRED_VERSION_linux-emac = "4.9%"

PREFERRED_PROVIDER_virtual/kernel:sama5 = "linux-emac"
PREFERRED_PROVIDER_virtual/kernel = "linux-emac"

PREFERRED_VERSION_linux-emac:sama5 = "4.9%"
PREFERRED_VERSION_linux-emac = "4.9%"

EXTRA_IMAGEDEPENDS:remove = "at91bootstrap-sam-ba"
EXTRA_IMAGEDEPENDS:append = " \
    u-boot-emac-at91 \
    at91bootstrap \
    linux-emac \
"

PREFERRED_PROVIDER_virtual/xserver ?= "xserver-xorg"
XSERVER ?= " \
    xserver-xorg \
    xserver-xorg-extension-dri2 \
    xserver-xorg-extension-glx \
    xserver-xorg-extension-extmod \
    xserver-xorg-extension-dbe \
    xf86-input-mouse \
    xf86-input-keyboard \
    xf86-input-evdev \
    xf86-video-fbdev \
    xf86-input-tslib \
"

SERIAL_CONSOLE ?= "115200 ttyS0"
IMAGE_FSTYPES ?= "tar.gz"
```

## meta-emac-atmel/conf/machine/include/emac-a5d.inc
```bitbake
MACHINEOVERRIDES =. "sama5:sama5d3:"

KERNEL_IMAGETYPE ?= "zImage"
KERNEL_DEVICETREE_BUNDLE ?= "1"

AT91BOOTSTRAP_MACHINE ?= "${MACHINE}"
UBOOT_MACHINE ?= "soma5d35_spiflash_config"

require conf/machine/include/sama5d3.inc

PREFERRED_PROVIDER_virtual/kernel:sama5 = "linux-emac"
PREFERRED_PROVIDER_virtual/kernel = "linux-emac"
PREFERRED_VERSION_linux-emac:sama5 = "4.19%"
PREFERRED_VERSION_linux-emac = "4.19%"
PREFERRED_PROVIDER_virtual/bootloader:sama5 = "u-boot-emac"
PREFERRED_PROVIDER_virtual/bootloader = "u-boot-emac"
PREFERRED_PROVIDER_u-boot:sama5 = "u-boot-emac"
PREFERRED_PROVIDER_u-boot = "u-boot-emac"
PREFERRED_VERSION_at91bootstrap = "v3.9.3+gitAUTOINC+4a055866e2"
EXTRA_IMAGEDEPENDS:remove = "at91bootstrap-sam-ba"

EXTRA_IMAGEDEPENDS:append = " \
    u-boot-emac \
    at91bootstrap \
    linux-emac \
"

PREFERRED_PROVIDER_virtual/xserver ?= "xserver-xorg"
XSERVER ?= " \
    xserver-xorg \
    xserver-xorg-extension-dri2 \
    xserver-xorg-extension-glx \
    xserver-xorg-extension-extmod \
    xserver-xorg-extension-dbe \
    xf86-input-mouse \
    xf86-input-keyboard \
    xf86-input-evdev \
    xf86-video-fbdev \
    xf86-input-tslib \
"

MACHINE_FEATURES:prepend = " arm mtd "
SERIAL_CONSOLE ?= "115200 ttyS0"

IMAGE_FSTYPES ?= "tar.gz"
```

## meta-emac-atmel/conf/machine/include/emac-atmel-a5d.inc
```bitbake
MACHINEOVERRIDES =. "sama5:sama5d3:"

include conf/machine/include/sama5d3.inc

PREFERRED_PROVIDER_virtual/kernel:sama5 = "linux-emac"
PREFERRED_PROVIDER_virtual/kernel = "linux-emac"

PREFERRED_VERSION_linux-emac:sama5 = "4.19%"
PREFERRED_VERSION_linux-emac = "4.19%"

KERNEL_DEVICETREE_BUNDLE = "1"

PREFERRED_PROVIDER_virtual/bootloader:sama5 = "u-boot-emac"
PREFERRED_PROVIDER_virtual/bootloader = "u-boot-emac"

PREFERRED_PROVIDER_u-boot:sama5 = "u-boot-emac"
PREFERRED_PROVIDER_u-boot = "u-boot-emac"

EXTRA_IMAGEDEPENDS:remove = "at91bootstrap-sam-ba"

MACHINE_ESSENTIAL_EXTRA_RDEPENDS:append = " \
    kernel-image \
    kernel-devicetree \
    ${@bb.utils.contains('KERNEL_DEVICETREE_BUNDLE','1', 'kernel-image-zimage-bundle','',d)} \
    u-boot-emac \
    at91bootstrap \
    linux-emac \
"

PREFERRED_PROVIDER_virtual/xserver ?= "xserver-xorg"
XSERVER ?= " \
    xserver-xorg \
    xserver-xorg-extension-dri2 \
    xserver-xorg-extension-glx \
    xserver-xorg-extension-extmod \
    xserver-xorg-extension-dbe \
    xf86-input-mouse \
    xf86-input-keyboard \
    xf86-input-evdev \
    xf86-video-fbdev \
    xf86-input-tslib \
"

MACHINE_FEATURES:prepend = " arm "
SERIAL_CONSOLE ?= "115200 ttyS0"
KERNEL_IMAGETYPE ?= "zImage"

UBOOT_MACHINE ?= "soma5d35_spiflash_config"

IMAGE_FSTYPES ?= "tar.gz"
```

## meta-emac-atmel/conf/machine/ipac9x25.conf
```bitbake
#@TYPE: Machine
#@NAME: ipac9x25
#@DESCRIPTION: Machine configuration for ipac9x25.

require conf/machine/include/at91sam9x5.inc

MACHINE_FEATURES = "apm alsa can ext2 rtc serial usbhost usbgadget vfat"
KERNEL_DEVICETREE = "ipac9x25.dtb"

IMAGE_FSTYPES:append = " tar.gz wic"

do_image_wic[depends] += "u-boot-at91:do_deploy"
WKS_FILE = "sdimage-bootpart.wks"
IMAGE_BOOT_FILES = "BOOT.BIN u-boot.bin uboot.env zImage ${KERNEL_DEVICETREE}"

UBOOT_MACHINE ?= "ipac9x25_mmc_defconfig"
UBOOT_ENTRYPOINT = "0x20008000"
UBOOT_LOADADDRESS = "0x20008000"
UBOOT_ENV_SIZE = "0x4000"

AT91BOOTSTRAP_MACHINE ?= "ipac9x25"

# Needed for FIT
#MACHINE_ESSENTIAL_EXTRA_RDEPENDS = " dt-overlay-mchp"

SERIAL_CONSOLE = "115200 ttyS5"

# Has an 8MB Serial Flash
# 0x0 - 0x7F_FFFF

EXTRA_IMAGEDEPENDS:append = " sam-ba-util-native"
```

## meta-emac-atmel/conf/machine/som9g20.conf
```bitbake
#@TYPE: Machine
#@NAME: som9g20

#@DESCRIPTION: Machine configuration for som9g20

MACHINE_FEATURES:append = " mtd wifi sound "
KERNEL_DEVICETREE = " \
    som-9g20-150es.dtb \
    som-9g20-112es.dtb \
"
AT91BOOTSTRAP_MACHINE = "som9g20"
UBOOT_MACHINE = "som9g20_config"

require conf/machine/include/emac-9g.inc

SERIAL_CONSOLE = "115200 ttyS0"
USE_VT = "0"

IMAGE_FSTYPES = "jffs2.sum"

JFFS2_ERASEBLOCK = "0x20000"
JFFS2_SUM_EXTRA_ARGS = "-e 0x20000 --no-cleanmarkers"

SOM_NUMBER = "02"
BOOTSTRAP_REV = "00.000"
UBOOT_REV = "00.001"
KERNEL_REV = "00.001"
FILESYSTEM_REV = "00.000"
```

## meta-emac-atmel/conf/machine/som9g45.conf
```bitbake
#@TYPE: Machine
#@NAME: Som9g45
#@DESCRIPTION: Machine configuration for EMAC's Som-9g45

MACHINE_FEATURES:append = " mtd screen touchscreen wifi sound "

KERNEL_DEVICETREE = " \
	som-9g45-200es.dtb \
	som-9g45-200gs.dtb \
	som-9g45-210es.dtb \
	som-9g45-212es.dtb \
	som-9g45-250es.dtb \
	som-9g45-250gs.dtb \
"

UBOOT_MACHINE = "som9m10g45_config"
AT91BOOTSTRAP_MACHINE = "som9g45"

require conf/machine/include/emac-9g.inc

IMAGE_FSTYPES = "jffs2.sum"

JFFS2_ERASEBLOCK = "0x20000"
JFFS2_SUM_EXTRA_ARGS = "-e 0x20000 --no-cleanmarkers"

SOM_NUMBER = "05"
BOOTSTRAP_REV = "00.001"
UBOOT_REV = "00.000"
KERNEL_REV = "00.000"
FILESYSTEM_REV = "00.000"
```

## meta-emac-atmel/conf/machine/som9x25.conf
```bitbake
#@TYPE: Machine
#@NAME: som9x25
#@DESCRIPTION: Machine configuration for som9x25

MACHINE_FEATURES:append = " can wifi sound "

KERNEL_DEVICETREE = "som-9x25-150es.dtb"
UBOOT_MACHINE = "som9x25_config"
AT91BOOTSTRAP_MACHINE = "som9x25"

require conf/machine/include/emac-9g.inc

SERIAL_CONSOLE = "115200 ttyS5"
USE_VT = "0"

SOM_NUMBER = "04"
BOOTSTRAP_REV = "00.000"
UBOOT_REV = "00.002"
KERNEL_REV = "00.001"
FILESYSTEM_REV = "00.000"
```

## meta-emac-atmel/conf/machine/soma5d35.conf
```bitbake
#@TYPE: Machine
#@NAME: SoM-A5D35
#@DESCRIPTION: Machine configuration for EMAC's Som-A5D35

MACHINE_FEATURES:append = " can mtd "
KERNEL_DEVICETREE = " \
    som-a5d35-150es.dtb \
    som-a5d35-112es.dtb \
"

UBOOT_MACHINE = "soma5d35_spiflash_config"
AT91BOOTSTRAP_MACHINE = "soma5d35"

require conf/machine/include/emac-a5d.inc

MACHINE_EXTRA_RDEPENDS:append = " linux-firmware-bcm43430 "

USE_VT = "0"

SOM_NUMBER = "06"
BOOTSTRAP_REV = "00.001"
UBOOT_REV = "00.001"
KERNEL_REV = "00.000"
FILESYSTEM_REV = "00.000"
```

## meta-emac-atmel/conf/machine/soma5d36.conf
```bitbake
#@TYPE: Machine
#@Name: ATMEL SAMA5D3 Xplained SD
#@DESCRIPTION: Machine configuration for Atmel's evaluation board

require conf/machine/include/sama5d3.inc

MACHINE_FEATURES = "apm alsa can ext2 rtc serial usbhost usbgadget vfat screen touchscreen wifi"
KERNEL_DEVICETREE = "som-a5d36-215gs.dtb"
IMAGE_FSTYPES += " tar.gz wic"

do_image_wic[depends] += "u-boot-at91:do_deploy"
WKS_FILE = "sdimage-bootpart.wks"
IMAGE_BOOT_FILES = "BOOT.BIN u-boot.bin uboot.env zImage ${KERNEL_DEVICETREE}"

# used by sysvinit_2
SERIAL_CONSOLES ?= "115200;ttyS0 115200;ttyGS0"

UBOOT_MACHINE ?= "soma5d36_mmc_defconfig"
UBOOT_ENTRYPOINT = "0x20008000"
UBOOT_LOADADDRESS = "0x20008000"
UBOOT_ENV_SIZE = "0x4000"

AT91BOOTSTRAP_MACHINE ?= "soma5d36"

# Needed for FIT
#MACHINE_ESSENTIAL_EXTRA_RDEPENDS = " dt-overlay-mchp"

# Has an 8MB Serial Flash
# 0x0 - 0x7F_FFFF
EXTRA_IMAGEDEPENDS:append = " sam-ba-util-native"
```

## meta-emac-bsp/conf/layer.conf
```bitbake
# We have a conf and classes directory, add to BBPATH
BBPATH .= ":${LAYERDIR}"

# We have recipes-* directories, add to BBFILES
BBFILES += "${LAYERDIR}/recipes-*/*/*.bb \
            ${LAYERDIR}/recipes-*/*/*.bbappend"

BBFILE_COLLECTIONS += "emac-bsp"
BBFILE_PATTERN_emac-bsp = "^${LAYERDIR}/"
BBFILE_PRIORITY_emac-bsp = "20"
LAYERVERSION_emac-bsp = "4"
LAYERSERIES_COMPAT_emac-bsp = "dunfell kirkstone"

LAYERDEPENDS_emac-bsp= " "

require ${LAYERDIR}/conf/machine-layer-depends.inc

BBFILES_DYNAMIC += " \
    yoctobsp:${LAYERDIR}/vendor-layers/yoctobsp/recipes-*/*/*.bb \
    yoctobsp:${LAYERDIR}/vendor-layers/yoctobsp/recipes-*/*/*.bbappend \
    atmel:${LAYERDIR}/vendor-layers/atmel/recipes-*/*/*.bb \
    atmel:${LAYERDIR}/vendor-layers/atmel/recipes-*/*/*.bbappend \
    freescale:${LAYERDIR}/vendor-layers/freescale/recipes-*/*/*.bb \
    freescale:${LAYERDIR}/vendor-layers/freescale/recipes-*/*/*.bbappend \
    intel:${LAYERDIR}/vendor-layers/intel/recipes-*/*/*.bb \
    intel:${LAYERDIR}/vendor-layers/intel/recipes-*/*/*.bbappend \
    meta-ti-bsp:${LAYERDIR}/vendor-layers/texas-instruments/recipes-*/*/*.bb \
    meta-ti-bsp:${LAYERDIR}/vendor-layers/texas-instruments/recipes-*/*/*.bbappend \
"
```
