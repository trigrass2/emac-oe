## meta-emac-bsp/conf/machine/arm/ipac9x25.conf
```bitbake
#@TYPE: Machine
#@NAME: ipac9x25

#@DESCRIPTION: Machine configuration for ipac9x25.

MACHINE_FEATURES += "bigflash can"
EXTRA_IMAGEDEPENDS += "u-boot-emac-at91 at91bootstrap"

include conf/machine/include/emac-arm-at91.inc
include conf/machine/include/tune-arm926ejs.inc

SERIAL_CONSOLE = "115200 ttyS5"
USE_VT = "0"

KERNEL_DEVICETREE = "ipac-9x25.dtb"
UBOOT_MACHINE = "ipac9x25_config"

SOM_NUMBER = "08"
BOOTSTRAP_REV = "00.000"
UBOOT_REV = "00.000"
KERNEL_REV = "00.000"
FILESYSTEM_REV = "00.000"
```

## meta-emac-bsp/conf/machine/arm/som3354.conf
```bitbake
#@TYPE: Machine
#@NAME: SoM3354

#@DESCRIPTION: Machine configuration for EMAC's SoM-3354

MACHINE_FEATURES += " bigflash can screen touch sound "

include conf/machine/include/emac-omap.inc
include conf/machine/include/tune-cortexa8.inc

KERNEL_DEVICETREE = " \
	som-3354-200es.dtb \
	som-3354-250es-7.dtb \
	som-3354-250es-10.dtb \
"

UBOOT_MACHINE = "som3354_spiboot_config"

SOM_NUMBER = "08"
CARRIER_NUMBER = "X"
REV = "1"
```

## meta-emac-bsp/conf/machine/arm/som3517.conf
```bitbake
#@TYPE: Machine
#@NAME: SoM3517

#@DESCRIPTION: Machine configuration for EMAC's SoM-3517

MACHINE_FEATURES += "bigflash can screen touchscreen"

include conf/machine/include/emac-omap.inc
include conf/machine/include/tune-cortexa8.inc

SERIAL_CONSOLE = "115200 ttyO2"

KERNEL_DEVICETREE = " \
	som-3517-210es.dtb \
	som-3517-212es.dtb \
	som-3517-250gs-7.dtb \
"

SPL_BINARY = "MLO"
UBOOT_MACHINE = "som3517_config"
UBOOT_SUFFIX = "img"

SOM_NUMBER = "09"
BOOTSTRAP_REV = "00.000"
UBOOT_REV = "00.000"
KERNEL_REV = "00.000"
FILESYSTEM_REV = "00.000"
```

## meta-emac-bsp/conf/machine/arm/som9g20.conf
```bitbake
#@TYPE: Machine
#@NAME: som9g20

#@DESCRIPTION: Machine configuration for som9g20

MACHINE_FEATURES += "bigflash mtd"
EXTRA_IMAGEDEPENDS += "u-boot-emac-at91 at91bootstrap"

include conf/machine/include/emac-arm-at91.inc
include conf/machine/include/tune-arm926ejs.inc

SERIAL_CONSOLE = "115200 ttyS0"

IMAGE_FSTYPES = "jffs2.sum"

JFFS2_ERASEBLOCK = "0x20000"
JFFS2_SUM_EXTRA_ARGS = "-e 0x20000 --no-cleanmarkers"

KERNEL_DEVICETREE = "som-9g20-150es.dtb som-9g20-112es.dtb"
UBOOT_MACHINE = "som9g20_config"

SOM_NUMBER = "02"
BOOTSTRAP_REV = "00.000"
UBOOT_REV = "00.001"
KERNEL_REV = "00.001"
FILESYSTEM_REV = "00.000"
```

## meta-emac-bsp/conf/machine/arm/som9g25.conf
```bitbake
#@TYPE: Machine
#@NAME: som9g25

#@DESCRIPTION: Machine configuration for som9g25

MACHINE_FEATURES += "bigflash mtd"

include conf/machine/include/emac-arm-at91.inc
include conf/machine/include/tune-arm926ejs.inc

SERIAL_CONSOLE = "115200 ttyS5"

IMAGE_FSTYPES = "jffs2.sum"

JFFS2_ERASEBLOCK = "0x20000"
JFFS2_SUM_EXTRA_ARGS = "-e 0x20000 --no-cleanmarkers"

KERNEL_DEVICETREE = "som-9g25-150es.dtb"
UBOOT_MACHINE = "som9g25_config som9g25_128M_config"
AT91BOOTSTRAP_MACHINE = "som9g25_64M som9g25_128M"

SOM_NUMBER = "03"
BOOTSTRAP_REV = "00.000"
UBOOT_REV = "00.000"
KERNEL_REV = "00.000"
FILESYSTEM_REV = "00.000"
```

## meta-emac-bsp/conf/machine/arm/som9g45.conf
```bitbake
#@TYPE: Machine
#@NAME: Som9g45

#@DESCRIPTION: Machine configuration for EMAC's Som-9g45

MACHINE_FEATURES += "bigflash mtd screen touchscreen"

include conf/machine/include/emac-arm-at91.inc
include conf/machine/include/tune-arm926ejs.inc

IMAGE_FSTYPES = "jffs2.sum"

JFFS2_ERASEBLOCK = "0x20000"
JFFS2_SUM_EXTRA_ARGS = "-e 0x20000 --no-cleanmarkers"

KERNEL_DEVICETREE = " \
	som-9g45-200es.dtb \
	som-9g45-200gs.dtb \
	som-9g45-210es.dtb \
	som-9g45-212es.dtb \
	som-9g45-250es.dtb \
"
UBOOT_MACHINE = "som9m10g45_config"

SOM_NUMBER = "05"
BOOTSTRAP_REV = "00.001"
UBOOT_REV = "00.000"
KERNEL_REV = "00.000"
FILESYSTEM_REV = "00.000"
```

## meta-emac-bsp/conf/machine/arm/som9x25.conf
```bitbake
#@TYPE: Machine
#@NAME: som9x25

#@DESCRIPTION: Machine configuration for som9x25

MACHINE_FEATURES += "bigflash can"

include conf/machine/include/emac-arm-at91.inc
include conf/machine/include/tune-arm926ejs.inc

SERIAL_CONSOLE = "115200 ttyS5"

KERNEL_DEVICETREE = "som-9x25-150es.dtb"
UBOOT_MACHINE = "som9x25_config"

SOM_NUMBER = "04"
BOOTSTRAP_REV = "00.000"
UBOOT_REV = "00.002"
KERNEL_REV = "00.000"
FILESYSTEM_REV = "00.000"
```

## meta-emac-bsp/conf/machine/arm/somA5D35.conf
```bitbake
#@TYPE: Machine
#@NAME: somA5D35

#@DESCRIPTION: Machine configuration for EMAC's Som-A5D35

MACHINE_FEATURES += " bigflash sound can "

include conf/machine/include/emac-arm-at91.inc
include conf/machine/include/tune-cortexa5.inc

KERNEL_DEVICETREE = "som-a5d35-150es.dtb"
UBOOT_MACHINE = "soma5d35_spiflash_config"

SOM_NUMBER = "06"
CARRIER_NUMBER = "X"
REV = "1"

DEFAULTTUNE = "cortexa5"
```

## meta-emac-bsp/conf/machine/arm/somA5D36.conf
```bitbake
#@TYPE: Machine
#@NAME: SomA5d36

#@DESCRIPTION: Machine configuration for EMAC's Som-A5d36.

MACHINE_FEATURES += " bigflash can screen touch sound "

include conf/machine/include/emac-arm-at91.inc
include conf/machine/include/tune-cortexa5.inc

KERNEL_DEVICETREE = "som-a5d36-200gs.dtb"
UBOOT_MACHINE = "soma5d36_spiflash_config"

SOM_NUMBER = "07"
BOOTSTRAP_REV = "00.000"
UBOOT_REV = "00.001"
KERNEL_REV = "00.000"
FILESYSTEM_REV = "00.000"

DEFAULTTUNE = "cortexa5"
```

## meta-emac-bsp/conf/machine/arm/soma5d35.conf
```bitbake
#@TYPE: Machine
#@NAME: SoM-A5D35

#@DESCRIPTION: Machine configuration for EMAC's Som-A5D35

MACHINE_FEATURES += "bigflash can wifi sound"
EXTRA_IMAGEDEPENDS += "u-boot-emac-at91 at91bootstrap"

MACHINE_EXTRA_RDEPENDS += "linux-firmware-bcm43430"
USE_VT = "0"

include conf/machine/include/emac-arm-at91.inc
include conf/machine/include/tune-cortexa5.inc

KERNEL_DEVICETREE = "som-a5d35-150es.dtb som-a5d35-112es.dtb"
UBOOT_MACHINE = "soma5d35_spiflash_config"

SOM_NUMBER = "06"
BOOTSTRAP_REV = "00.001"
UBOOT_REV = "00.001"
KERNEL_REV = "00.000"
FILESYSTEM_REV = "00.000"

DEFAULTTUNE = "cortexa5"
```

## meta-emac-bsp/conf/machine/arm/soma5d36.conf
```bitbake
#@TYPE: Machine
#@NAME: SoM-A5D36

#@DESCRIPTION: Machine configuration for EMAC's Som-A5d36.

MACHINE_FEATURES += "bigflash can screen touchscreen"

MACHINE_EXTRA_RDEPENDS += "wf111-driver wf111-driver-tools wf111-driver-fw linux-firmware-sd8787"

include conf/machine/include/emac-arm-at91.inc
include conf/machine/include/tune-cortexa5.inc

KERNEL_DEVICETREE = "som-a5d36-200gs.dtb som-a5d36-215gs.dtb som-a5d36-250gs.dtb"
UBOOT_MACHINE = "soma5d36_spiflash_config"

SOM_NUMBER = "07"
BOOTSTRAP_REV = "00.000"
UBOOT_REV = "01.000"
KERNEL_REV = "00.000"
FILESYSTEM_REV = "00.000"

DEFAULTTUNE = "cortexa5"
```

## meta-emac-bsp/conf/machine/arm/somimx6-rt.conf
```bitbake
#@TYPE: Machine
#@NAME: SoMIMX6-Xenomai

#@DESCRIPTION: Machine configuration for EMAC's SoM-imx6 with Xenomai

include conf/machine/arm/somimx6.conf

MACHINE_FEATURES += "rt"

PREFERRED_PROVIDER_virtual/kernel = "linux-emac-rt"
PREFERRED_VERSION_linux-xenomai = "4.9%"
```
