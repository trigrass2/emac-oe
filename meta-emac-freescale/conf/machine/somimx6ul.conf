## meta-emac-ti/meta-emac-ti-bsp/conf/machine/som3354.conf
```bitbake
#@TYPE: Machine
#@NAME: SoM3354
#@DESCRIPTION: Machine configuration for EMAC's SoM-3354

MACHINEOVERRIDES =. "ti:ti33x:"

include conf/machine/include/ti33x.inc

MACHINE_FEATURES:append = " can screen touchscreen sound wifi gpu mtd arm "
MACHINE_EXTRA_RDEPENDS:append = " linux-firmware-sd8787 "

PREFERRED_PROVIDER_virtual/kernel = "linux-ti-staging"
PREFERRED_VERSION_linux-libc-headers = "5.10%"
MACHINE_ESSENTIAL_EXTRA_RDEPENDS:append = " \
    kernel-image \
    kernel-devicetree \
    ${@bb.utils.contains('KERNEL_DEVICETREE_BUNDLE','1', 'kernel-image-zimage-bundle','',d)} \
"
KERNEL_DEVICETREE_BUNDLE = "1"
KERNEL_IMAGETYPE = "zImage"
KERNEL_DEVICETREE = " \
	som-3354-200es.dtb \
	som-3354-200gs.dtb \
	som-3354-210es.dtb \
	som-3354-212es.dtb \
	som-3354-250es-7.dtb \
	som-3354-250es-10.dtb \
	som-3354-250gs-7.dtb \
"


PREFERRED_PROVIDER_virtual/bootloader = "u-boot-emac"
PREFERRED_VERSION_u-boot-emac = "v2020.04%"
MACHINE_ESSENTIAL_EXTRA_RDEPENDS:append = " ${PREFERRED_PROVIDER_virtual/bootloader}"

UBOOT_MACHINE = "som3354_spiboot_config"
UBOOT_SUFFIX = "img"
SPL_BINARY = "MLO.byteswap spl/u-boot-spl.bin"

SERIAL_CONSOLES = "115200;ttyO0"

IMAGE_FSTYPES += " tar.gz "
IMAGE_FSTYPES:remove = " wic wic.bmap ubifs ubi "
PREFERRED_PROVIDER_virtual/egl = "ti-sgx-ddk-um"
PREFERRED_PROVIDER_virtual/libgles1 = "ti-sgx-ddk-um"
PREFERRED_PROVIDER_virtual/libgles2 = "ti-sgx-ddk-um"
PREFERRED_PROVIDER_virtual/libgbm = "ti-sgx-ddk-um"
PREFERRED_PROVIDER_virtual/gpudriver = "ti-sgx-ddk-km"

PREFERRED_PROVIDER_libltdl ="libtool"

MACHINE_EXTRA_RDEPENDS += " \
	ti-sgx-ddk-km \
	ti-sgx-ddk-um \
	ti-codec-engine \
	alsa-state \
	wayland-dev  \
	libegl-dev \
	libdrm-dev \
	libegl \
	glmark2 \
	libdrm-kms \
	libegl \
	kmscube \
	img-pvr-sdk \
"
	
#	protection-relays-hmi 
#	mmwavegesture-hmi 
#	evse-hmi 
# * bsp
# vxd-dec-fw
# cmem 
# uio-module-drv

# * extras
# bt-fw
# wl18xx-fw
# wl18xx-calibrator
# wl18xx-target-scripts
# wlconf
# uim-sysfs(sys5)
# cuia
# ti-sysbios
# ti-framework-components
# ti-osal
# swtools
# ti-xdais

# * arago-distro
# glmark2
# arm-benchmarks
# nbench-byte
## stream
# gtk+3 gtk+3-demo
# opencl opencl-runtime opencl-examples-offline-compile

SOM_NUMBER = "08"
BOOTSTRAP_REV = "00.000"
UBOOT_REV = "00.000"
KERNEL_REV = "00.000"
FILESYSTEM_REV = "00.000"
```

## meta-emac-ti/meta-emac-ti-extras/conf/layer.conf
```bitbake
# We have a conf and classes directory, append to BBPATH
BBPATH .= ":${LAYERDIR}"

# We have recipes-* directories, add to BBFILES
BBFILES += "${LAYERDIR}/recipes-*/*/*.bb \
             ${LAYERDIR}/recipes-*/*/*.bbappend"

BBFILE_COLLECTIONS += "meta-emac-ti-extras"
BBFILE_PATTERN_meta-emac-ti-extras := "^${LAYERDIR}/"
BBFILE_PRIORITY_meta-emac-ti-extras = "8"

LAYERSERIES_COMPAT_meta-emac-ti-extras = "kirkstone"

LAYERDEPENDS_meta-emac-ti-extras = " \
    core \
    emac-core \
    meta-ti-extras \
    meta-arm \
    arm-toolchain \
"

LAYERRECOMMENDS_meta-emac-ti-extras = " \
    meta-arago-extras \
"

BBFILES_DYNAMIC += " \
    qt5-layer:${LAYERDIR}/dynamic-layers/qt5-layer/recipes*/*/*.bb \
"
```

## meta-emac-web/meta-chromium/conf/layer.conf
```bitbake
# We have a conf and classes directory, append to BBPATH
BBPATH .= ":${LAYERDIR}"

# We have a recipes directory, add to BBFILES
BBFILES += "${LAYERDIR}/recipes-*/*/*.bb ${LAYERDIR}/recipes-*/*/*.bbappend"

BBFILE_COLLECTIONS += "emac-chromium-browser-layer"
BBFILE_PATTERN_emac-chromium-browser-layer := "^${LAYERDIR}/"
BBFILE_PRIORITY_emac-chromium-browser-layer = "7"

LAYERVERSION_emac-chromium-browser-layer = "1"
LAYERSERIES_COMPAT_emac-chromium-browser-layer = "kirkstone"

LAYERDEPENDS_emac-chromium-browser-layer = " \
    clang-layer \
    core \
    openembedded-layer \
    chromium-browser-layer \
"
```

## meta-emac-web/meta-webserver/conf/layer.conf
```bitbake
# We have a conf and classes directory, append to BBPATH
BBPATH .= ":${LAYERDIR}"

# We have a recipes directory, add to BBFILES
BBFILES += "${LAYERDIR}/recipes-*/*/*.bb ${LAYERDIR}/recipes-*/*/*.bbappend"

BBFILE_COLLECTIONS += "emac-webserver-layer"
BBFILE_PATTERN_emac-webserver-layer := "^${LAYERDIR}/"
BBFILE_PRIORITY_emac-webserver-layer = "7"

LAYERVERSION_emac-webserver-layer = "1"
LAYERSERIES_COMPAT_emac-webserver-layer = "kirkstone"

LAYERDEPENDS_emac-webserver-layer = " \
    core \
    openembedded-layer \
    webserver \
"
```

## meta-emac-xenomai/conf/layer.conf
```bitbake
# We have a conf and classes directory, append to BBPATH
BBPATH .= ":${LAYERDIR}"

# We have a recipes directory, add to BBFILES
BBFILES += "${LAYERDIR}/recipes-*/*/*.bb ${LAYERDIR}/recipes-*/*/*.bbappend"

BBFILE_COLLECTIONS += "emac-xenomai-layer"
BBFILE_PATTERN_emac-xenomai-layer := "^${LAYERDIR}/"
BBFILE_PRIORITY_emac-xenomai-layer = "7"

LAYERVERSION_emac-xenomai-layer = "1"
LAYERSERIES_COMPAT_emac-xenomai-layer = "kirkstone"

LAYERDEPENDS_emac-xenomai-layer = " \
    core \
    openembedded-layer \
"
```

## meta-emac-xenomai/conf/machine/somimx6-xenomai.conf
```bitbake
#@TYPE: Machine
#@NAME: SoMIMX6-Xenomai

#@DESCRIPTION: Machine configuration for EMAC's SoM-imx6 with Xenomai

include conf/machine/include/emac-imx6.inc

PREFERRED_PROVIDER_virtual/kernel = "linux-xenomai"
PREFERRED_VERSION_linux-xenomai = "4.9.95-ipipe%"
```

## meta-emac/conf/bblayers.conf.sample
```bitbake
# LAYER_CONF_VERSION is increased each time build/conf/bblayers.conf
# changes incompatibly
LCONF_VERSION = "5"

BBPATH = "${TOPDIR}"
BBFILES ?= ""

BBLAYERS ?= " \
  ##OEROOT##/recipes/emac-oe/meta-emac \
\
  ##OEROOT##/recipes/poky/meta \
  ##OEROOT##/recipes/meta-openembedded/meta-oe \
  ##OEROOT##/recipes/meta-openembedded/meta-networking \
  ##OEROOT##/recipes/meta-openembedded/meta-python \
  ##OEROOT##/recipes/meta-openembedded/meta-efl \
  ##OEROOT##/recipes/meta-openembedded/meta-multimedia \
  ##OEROOT##/recipes/meta-openembedded/meta-gnome \
  "
```

## meta-emac/conf/distro/emac-tiny.conf
```bitbake
include conf/distro/poky-tiny.conf 
DISTRO = "emac-tiny"
DISTROOVERRIDES = "poky:poky-tiny:emac:emac-tiny"
DISTRO_FEATURES = " pci ipv4 ipv6 usbhost "
INIT_MANAGER = "mdev-busybox"
IMAGE_FSTYPES = "cpio.gz tar.gz"
QB_DEFAULT_FSTYPE = "cpio.gz"

######################
## SDK
######################
TARGET_VENDOR = "-emac"
SDK_VENDOR = "-emacsdk"
SDK_NAME = "${MACHINE}-${DISTRO}-${SDK_ARCH}-toolchain-${DISTRO_VERSION}-${TUNE_PKGARCH}"
SDK_VERSION = "${MAJOR_DISTRO_VERSION}.${MINOR_DISTRO_VERSION}"
SDKPATH  = "/opt/${DISTRO}/${SDK_VERSION}-${MACHINE}"

SDK_DEPLOY ?= "${TMPDIR}/deploy/sdk/${MACHINE}"\

######################
## MISC SETTINGS
######################
TOOLCHAIN_OUTPUTNAME ?= "${SDK_NAME}"
BB_SIGNATURE_HANDLER ?= 'OEBasicHash'
FONTCONFIG_CACHE_DIR = "${libdir}/fontconfig/cache"

LICENSE_FLAGS_ACCEPTED:append = " \
    commercial_mpg123 \
    commercial_libav \
    commercial_x264 \
    commercial \
"
ACCEPT_FSL_EULA = "1"

SANITY_TESTED_DISTROS ?= " \
    ubuntu-14.04 \n \
    ubuntu-16.04 \n \
    ubuntu-18.04 \n \
    ubuntu-20.04 \n \
    ubuntu-21.04 \n \
    ubuntu-21.10 \n \
    fedora-24 \n \
    fedora-25 \n \
    centos-7 \n \
    debian-8 \n \
    opensuse-42.1 \n \
    opensuse-42.2 \n \
"

######################
## QA
######################
# QA check settings - a little stricter than the OE-Core defaults
WARN_QA = "textrel files-invalid incompatible-license xorg-driver-abi libdir \
           unknown-configure-option"
ERROR_QA = "dev-so debug-deps dev-deps debug-files arch pkgconfig la perms \
            useless-rpaths rpaths staticdev ldflags pkgvarcheck already-stripped \
            compile-host-path dep-cmp installed-vs-shipped install-host-path \
            packages-list perm-config perm-line perm-link pkgv-undefined \
            pn-overrides split-strip var-undefined version-going-backwards"
            

#######################################
## EXTRA INCLUDE PRE MACHINE BASED
## This is optional but really helps
## when dealing with vendor code (nxp,tegra,ect)
#######################################
include conf/distro/include/machine/${MACHINE}.conf 
```
