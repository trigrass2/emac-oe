## meta-emac-freescale/conf/machine/somimx6ul.conf
```bitbake
#@TYPE: Machine
#@NAME: SoMIMX6UL
#@DESCRIPTION: Machine configuration for EMAC's SoM-imx6ul

MACHINE_FEATURES:append = " pci can wifi sound bigflash can "
MACHINEOVERRIDES =. "mx6:mx6ul:"

include conf/machine/include/emac-imx6.inc
include conf/machine/include/arm/armv7a/tune-cortexa7.inc

MACHINE_EXTRA_RDEPENDS:append = " linux-firmware-bcm43430 "

KERNEL_DEVICETREE = " \
	som-imx6ul-150es.dtb \
	som-imx6ul-112es.dtb \
"

UBOOT_MACHINE = "somimx6ul_pmb_defconfig"

SERIAL_CONSOLES = "115200;ttymxc4"

SOM_NUMBER = "10"
BOOTSTRAP_REV = "00.000"
UBOOT_REV = "00.000"
KERNEL_REV = "00.000"
FILESYSTEM_REV = "00.000"
```

## meta-emac-intel/conf/layer.conf
```bitbake
# We have a conf and classes directory, add to BBPATH
BBPATH .= ":${LAYERDIR}"

# We have recipes-* directories, add to BBFILES
BBFILES += "${LAYERDIR}/recipes-*/*/*.bb \
            ${LAYERDIR}/recipes-*/*/*.bbappend"

BBFILE_COLLECTIONS += "emac-intel-layer"
BBFILE_PATTERN_emac-intel-layer = "^${LAYERDIR}/"
BBFILE_PRIORITY_emac-intel-layer = "7"

LAYERSERIES_COMPAT_emac-intel-layer = "kirkstone"
LAYERDEPENDS_emac-intel-layer = " \
    emac-core \
    intel \
"


## TODO add dynamic layers for qt 
```

## meta-emac-intel/conf/machine/atom-i7-browser.conf
```bitbake
#@TYPE: Machine
#@NAME: Emac Intel standered image
#@DESCRIPTION: qtwebbrowser with wayland intergration

include conf/machine/intel-corei7-64.conf
include conf/machine/include/emac-x86.conf

RESOLUTION = "1024x768"

MACHINE_FEATURES:append = " \
    wayland \
    touchscreen \
    x11 \
"

PREFERRED_PROVIDER_libva = "libva-intel"
PREFERRED_PROVIDER_libva-native = "libva-intel-native"
PREFERRED_PROVIDER_nativesdk-libva = "nativesdk-libva-intel"

PREFERRED_PROVIDER_libva-utils = "libva-utils-intel"
PREFERRED_PROVIDER_libva-native = "libva-utils-intel-native"
PREFERRED_PROVIDER_nativesdk-libva-utils = "nativesdk-libva-utils-intel"


MACHINE_EXTRA_RDEPENDS:append = " \
    grub-efi grub efibootmgr \
    weston weston-init \
    \
    libgl-mesa libgles1-mesa libgles2-mesa libgles3-dev \
    libegl-mesa libosmesa libglapi glfw glew libglu freeglut \
    \
    libgles3-mesa-dev \
    \
    linux-firmware-i915 linux-firmware-iwlwifi \
    gstreamer1.0-vaapi libva libva-utils intel-vaapi-driver \
    thermald \
    intel-media-driver intel-mediasdk \
    mesa-driver-i915 \
    \
    packagegroup-core-x11 \
    xserver-xf86-config \
    liberation-fonts \
    xkbcomp \
    xkeyboard-config \
"

## IMAGE
IMAGE_FSTYPES = "tar.gz wic"
WKS_FILE = "x86.wks.in"
do_image_wic[depends] += "gptfdisk-native:do_populate_sysroot"
do_image_wic[recrdeptask] += "do_bootimg"
```

## meta-emac-intel/conf/machine/ft10270.conf
```bitbake
#@TYPE: Machine
#@NAME: FT10270
#@DESCRIPTION: Machine configuration for Faytech 10270

# Not much info on the diytrade for the cpu info
# Intel Atom CPU, RAM 2G, 30G SSD
# * 2*10/100/1000 Mbps network parts, WiFi intergrated

include conf/machine/include/x86/emac-x86.inc
include conf/machine/include/x86/emac-x11.inc
include conf/machine/include/intel/tune-atom.inc

MACHINE_FEATURES:append = " touchscreen"
MACHINE_EXTRA_RDEPENDS:append = " xf86-video-ati linux-firmware-iwlwifi-4965-2 linux-firmware-radeon"

RESOLUTION = "1024x768"
```

## meta-emac-intel/conf/machine/ft8270.conf
```bitbake
#@TYPE: Machine
#@NAME: FT8270
#@DESCRIPTION: Machine configuration for Faytech 8270 (Intel Atom N270(1x1.6GHz))

# CPU: Intel Atom N270(1x1.6GHz)
# Memory: 2GB DDR 2 
# Hard Drive: 30GB SSD ||  60GB SSD


include conf/machine/include/x86/emac-x86.inc
include conf/machine/include/x86/emac-x11.inc
include conf/machine/include/intel/tune-atom.inc

MACHINE_FEATURES:append = " touchscreen"
MACHINE_EXTRA_RDEPENDS:append = " xf86-video-ati linux-firmware-iwlwifi-4965-2 linux-firmware-radeon"

RESOLUTION = "800x600"
```

## meta-emac-intel/conf/machine/include/atom.inc
```bitbake
# Machine configuration for core2-64(x86_64/i686)
# Default image for all atom based products

DEFAULTTUNE ?= "core2-64"
MACHINEOVERRIDES:prepend = "atom-sbc:"

include conf/machine/include/x86/emac-x86.inc
include conf/machine/include/x86/tune-core2.inc

MACHINE_FEATURES += " \
    atom-sbc \
"

PREFERRED_PROVIDER_libva = "libva-intel"
PREFERRED_PROVIDER_libva-native = "libva-intel-native"
PREFERRED_PROVIDER_nativesdk-libva = "nativesdk-libva-intel"

PREFERRED_PROVIDER_libva-utils = "libva-utils-intel"
PREFERRED_PROVIDER_libva-native = "libva-utils-intel-native"
PREFERRED_PROVIDER_nativesdk-libva-utils = "nativesdk-libva-utils-intel"

## intel based feature set 
MACHINE_EXTRA_RDEPENDS:append = " \
    grub-efi \
    grub \
    efibootmgr \
    \
    linux-firmware-i915 \
    linux-firmware-iwlwifi \
    \
    libva \
    libva-utils \
    intel-vaapi-driver \
    gstreamer1.0-vaapi \
    intel-media-driver \
    intel-mediasdk \
    libgles3-mesa-dev \
    thermald \
    ${@bb.utils.contains('EMAC_DISPLAY', 'x11', ' ${XSERVER} ', '', d )} \
    ${@bb.utils.contains('EMAC_DISPLAY_HW', 'opengl', ' mesa-driver-i915 ', '', d)} \
"
# kernel-module-i915 
# metee 


## Add with meta-intel
#MACHINE_EXTRA_RRECOMMENDS += " \
#    intel-vaapi-driver \
#    gstreamer1.0-vaapi \
#"

## BOOTLOADER
GRUB_TIMEOUT ?= "5"
#GRUB_GFXMODE = "1024x768x32"
#GRUB_COLOR_NORMAL="green/black"
#GRUB_COLOR_HIGHLIGHT="light-gray/light-magenta"

##UTILS


## MISC 
```

## meta-emac-qt/conf/layer.conf
```bitbake
# We have a conf and classes directory, add to BBPATH
BBPATH .= ":${LAYERDIR}"

# We have recipes-* directories, add to BBFILES
BBFILES += "${LAYERDIR}/recipes-*/*/*.bb \
            ${LAYERDIR}/recipes-*/*/*.bbappend"

BBFILE_COLLECTIONS += "emacqt"
BBFILE_PATTERN_emacqt = "^${LAYERDIR}/"
BBFILE_PRIORITY_emacqt = "7"

LAYERSERIES_COMPAT_emacqt = "dunfell"

# This is only used to be able to call the qtcreator script, during sdk generation
EMAC_QT5_META_DIR = "${LAYERDIR}/"
```

## meta-emac-qt4/conf/layer.conf
```bitbake
# We have a conf and classes directory, add to BBPATH
BBPATH .= ":${LAYERDIR}"

# We have recipes-* directories, add to BBFILES
BBFILES += "${LAYERDIR}/recipes-*/*/*.bb \
            ${LAYERDIR}/recipes-*/*/*.bbappend"

BBFILE_COLLECTIONS += "emac-qt4-layer"
BBFILE_PATTERN_emac-qt4-layer = "^${LAYERDIR}/"
BBFILE_PRIORITY_emac-qt4-layer = "7"

LAYERSERIES_COMPAT_emac-qt4-layer = "dunfell"

# This is only used to be able to call the qtcreator script, during sdk generation
EMAC_QT4_META_DIR = "${LAYERDIR}/"

LAYERDEPENDS_emac-qt4-layer = " \
    emac-core \
    qt4-layer \
"
```

## meta-emac-qt5/conf/layer.conf
```bitbake
# We have a conf and classes directory, add to BBPATH
BBPATH .= ":${LAYERDIR}"

# We have recipes-* directories, add to BBFILES
BBFILES += "${LAYERDIR}/recipes-*/*/*.bb \
            ${LAYERDIR}/recipes-*/*/*.bbappend"

BBFILE_COLLECTIONS += "emac-qt5-layer"
BBFILE_PATTERN_emac-qt5-layer = "^${LAYERDIR}/"
BBFILE_PRIORITY_emac-qt5-layer = "7"

LAYERSERIES_COMPAT_emac-qt5-layer = "kirkstone"
LAYERDEPENDS_emac-qt5-layer = " \
    emac-core \
    qt5-layer \
    meta-python2 \
"

# This is only used to be able to call the qtcreator script, during sdk generation
EMAC_QT5_META_DIR = "${LAYERDIR}/"
```

## meta-emac-tegra/conf/layer.conf
```bitbake
BBPATH =. "${LAYERDIR}:"
BBFILES += "${LAYERDIR}/recipes-*/*/*.bb ${LAYERDIR}/recipes-*/*/*.bbappend"

BBFILE_COLLECTIONS += "emac-tegra-layer"
BBFILE_PATTERN_emac-tegra-layer = "^${LAYERDIR}/"
BBFILE_PRIORITY_emac-tegra-layer = "50"

LAYERVERSION_emac-tegra-layer = "4"
LAYERSERIES_COMPAT_emac-tegra-layer = "dunfell"

# This is used by the emactegra-distro-sanity bbclass
# to identify the distro layer directory during
# bblayers checks.
TD_DISTRO_LAYERDIR = "${LAYERDIR}" 

LAYERDEPENDS_emac-tegra-layer = " \
    emac-core \
    tegra \
    virtualization-layer \
    tegra-contrib \
"
```

## meta-emac-ti/conf/layer.conf
```bitbake
# We have a conf and classes directory, append to BBPATH
BBPATH .= ":${LAYERDIR}"

# We have recipes-* directories, add to BBFILES
BBFILES += "${LAYERDIR}/recipes-*/*/*.bb \
             ${LAYERDIR}/recipes-*/*/*.bbappend"

BBFILE_COLLECTIONS += "emac-ti-bsp-layer"
BBFILE_PATTERN_emac-ti-bsp-layer := "^${LAYERDIR}/"
BBFILE_PRIORITY_emac-ti-bsp-layer = "8"

LAYERSERIES_COMPAT_emac-ti-bsp-layer = "kirkstone"

LAYERDEPENDS_emac-ti-bsp-layer = " \
    emac-bsp \
    meta-ti-bsp \
"

LAYERRECOMMENDS_emac-ti-bsp-layer = " \
    meta-arago-distro \
"
```

## meta-emac-ti/conf/machine/som-5728.conf
```bitbake
#@TYPE: Machine
#@NAME: c03439-00
#@DESCRIPTION: Machine configuration for 5228.

include conf/machine/include/tune-cortexa9.inc
include  conf/machine/include/soc-family.inc

PREFERRED_PROVIDER_virtual/libgl     = "ti-sgx-ddk-um"
PREFERRED_PROVIDER_virtual/egl       = "ti-sgx-ddk-um"
PREFERRED_PROVIDER_virtual/libgles1  = "ti-sgx-ddk-um"
PREFERRED_PROVIDER_virtual/libgles2  = "ti-sgx-ddk-um"
PREFERRED_PROVIDER_virtual/libgbm    = "ti-sgx-ddk-um"

MACHINE_FEATURES = " \
    arm \
    pci \
    apm \
    usbgadget \
    usbhost \
    vfat \ 
    ext3 \
    screen \
    alsa \
    ethernet \
    gpu \
    mmip \
    dsp \
    gc320 \
"

## DRA7XX OMAP-A15 RTOS packages
## recipes-bsp/board-rtos/board-rtos_git.bb
## recipes-bsp/edma3-lld/edma3-lld-rtos_git.bb
## recipes-bsp/emac-lld/emac-lld-rtos_git.bb
## recipes-bsp/fatfs-rtos/fatfs-rtos_git.bb
## recipes-bsp/gpio-lld/gpio-lld-rtos_git.bb
## recipes-bsp/i2c-lld/i2c-lld-rtos_git.bb
## recipes-bsp/mcasp-lld/mcasp-lld-rtos_git.bb
## recipes-bsp/mmcsd-lld/mmcsd-lld-rtos_git.bb
## recipes-bsp/pcie-lld/pcie-lld-rtos_git.bb
## recipes-bsp/pm-lld/pm-lld-rtos_git.bb
## recipes-bsp/spi-lld/spi-lld-rtos_git.bb
## recipes-bsp/transport-rtos/nimu-icss-rtos_git.bb
## recipes-bsp/transport-rtos/nimu-rtos_git.bb
## recipes-bsp/transport-rtos/timesync-rtos_git.bb
## recipes-bsp/uart-lld/uart-lld-rtos_git.bb
## recipes-bsp/usb-lld/usb-lld-rtos_git.bb
## recipes-bsp/utils-rtos/profiling-rtos_git.bb
## recipes-bsp/vps-lld/vps-lld-rtos_git.bb
## recipes-ti/openmp-rtos/openmp-rtos_git.bb
## recipes-ti/ti-pdk-build/ti-pdk-build-rtos_git.bb
## recipes-bsp/pru/pru-icss_git.bb

MACHINE_EXTRA_RDEPENDS += " \
    ti-gc320-libs \
    ti-gc320-driver \
    ti-sgx-ddk-km \
    ti-sgx-ddk-um \
    vpdma-fw \
    goodix-fw \
    ipumm-fw \
    kernel-modules \
    libulm \
    dsptop \
    uio-module-drv-test \
    spidev-test \
    i2c-tools \
    u-boot-ti-staging \
    prueth-fw prusw-fw pruhsr-fw pruprp-fw \
"


## KERNEL
PREFERRED_PROVIDER_virtual/kernel ?= "linux-ti-staging"
PREFERRED_VERSION_linux ?= "5.10%"
PREFERRED_VERSION_linux-ti-staging ?= "5.10%"


KERNEL_DEVICETREE = " \
    som-5728-5228.dtb \
"
KERNEL_MODULE_AUTOLOAD += " \
    galcore \
"

## UBOOT
PREFERRED_PROVIDER_virtual/bootloader = "u-boot-ti-staging"
PREFERRED_VERSION_u-boot-ti-staging = "2020.01%"
UBOOT_MACHINE = "som5728_defconfig"
UBOOT_SUFFIX = "img"

IMAGE_FSTYPES += " ext4 tar.gz "

SOM_NUMBER = "09"
UBOOT_REV = "01.000"
KERNEL_REV = "00.000"
FILESYSTEM_REV = "00.000"

SOC_FAMILY_append = "ti-soc:omap-a15:dra7xx:am57xx-evm"

# MACHINEOVERRIDES_append = ":ti-soc:omap-a15:dra7xx:am57xx-evm"
DEFAULTTUNE = "armv7athf-neon"
TI_PDK_LIMIT_SOCS = "am571x am572x am574x"
```

## meta-emac-ti/conf/machine/som3517.conf
```bitbake
#@TYPE: Machine
#@NAME: SoM3517
#@DESCRIPTION: Machine configuration for EMAC's SoM-3517

include /conf/machine/include/emac-omap.inc
include conf/machine/include/arm/armv7a/tune-cortexa8.inc

DEFAULTTUNE = "armv7athf-neon

MACHINE_FEATURES:append  = " can screen touchscreen sound wifi "
MACHINE_EXTRA_RDEPENDS:append = " wf111-driver wf111-driver-tools wf111-driver-fw linux-firmware-sd8787 "

SERIAL_CONSOLE = "115200 ttyO2"
SOM_NUMBER = "09"
BOOTSTRAP_REV = "00.000"
UBOOT_REV = "00.000"
KERNEL_REV = "00.000"
FILESYSTEM_REV = "00.000"

PREFERRED_PROVIDER_virtual/kernel ?= "linux-emac"
PREFERRED_VERSION_linux-emac = "4.9%"

PREFERRED_PROVIDER_virtual/bootloader ?= "u-boot-emac"
PREFERRED_VERSION_u-boot-emac = "v2016.01%"

KERNEL_DEVICETREE = " \
	som-3517-210es.dtb \
	som-3517-212es.dtb \
	som-3517-250gs-7.dtb \
"

SPL_BINARY = "MLO"
UBOOT_MACHINE = "som3517_config"
UBOOT_SUFFIX = "img"
```

## meta-emac-ti/meta-emac-arago-distro/conf/layer.conf
```bitbake
# We have a conf and classes directory, append to BBPATH
BBPATH .= ":${LAYERDIR}"

# We have recipes-* directories, add to BBFILES
BBFILES += "${LAYERDIR}/recipes-*/*/*.bb \
             ${LAYERDIR}/recipes-*/*/*.bbappend"

BBFILE_COLLECTIONS += "meta-emac-arago-distro"
BBFILE_PATTERN_meta-emac-arago-distro := "^${LAYERDIR}/"
BBFILE_PRIORITY_meta-emac-arago-distro = "9"

LAYERSERIES_COMPAT_meta-emac-arago-distro = "kirkstone"

LAYERDEPENDS_meta-emac-arago-distro = " \
    meta-emac-ti-bsp \
    meta-emac-ti-extras \
    meta-emac-arago-extras \
"


 
```

## meta-emac-ti/meta-emac-arago-extras/conf/layer.conf
```bitbake
# We have a conf and classes directory, append to BBPATH
BBPATH .= ":${LAYERDIR}"

# We have recipes-* directories, add to BBFILES
BBFILES += "${LAYERDIR}/recipes-*/*/*.bb \
             ${LAYERDIR}/recipes-*/*/*.bbappend"

BBFILE_COLLECTIONS += "meta-emac-arago-extras"
BBFILE_PATTERN_meta-emac-arago-extras := "^${LAYERDIR}/"
BBFILE_PRIORITY_meta-emac-arago-extras = "9"

LAYERSERIES_COMPAT_meta-emac-arago-extras = "kirkstone"

LAYERDEPENDS_meta-meta-emac-arago-extras = " \
    meta-emac-ti-bsp \
    meta-emac-ti-extras \
    meta-emac-arago-distro \
" 
```

## meta-emac-ti/meta-emac-ti-bsp/conf/distro/include/machine/som3354.conf
```bitbake
# Remove some unwanted features
DISTRO_FEATURES:remove = "x11"

# Add additional distro features
DISTRO_FEATURES:append = " pam wayland opengl"
#DISTRO_FEATURES:append = " opencl"
DISTRO_FEATURES:append = " opencv"
DISTRO_FEATURES:append = " openmp"

DISTRO_FEATURES_FILTER_NATIVE:append = " opencl opencv openmp"
DISTRO_FEATURES_FILTER_NATIVESDK:append = " opencl opencv openmp"

LICENSE_FLAGS_ACCEPTED = "commercial_gst-ffmpeg commercial_gstreamer1.0-libav commercial_faad2 non-commercial_netperf"

ASSUME_PROVIDED += "nativesdk-perl"
```
